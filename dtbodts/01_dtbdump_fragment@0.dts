/dts-v1/;

/ {

	__fixups__ {
		accdet = "/fragment@6:target:0";
		apuart0 = "/fragment@26:target:0";
		auxadc = "/fragment@21/__overlay__:io-channels:0\0/fragment@35:target:0\0/fragment@36/__overlay__:io-channels:0";
		charger = "/fragment@21:target:0";
		chosen = "/fragment@1:target:0";
		consys = "/fragment@16:target:0";
		dsi_te = "/fragment@56:target:0";
		fpc_interrupt = "/fragment@29:target:0";
		goodix_fp = "/fragment@31:target:0\0/fragment@58:target:0";
		gpio = "/fragment@49:target:0";
		gpio_usage_mapping = "/fragment@48:target:0";
		i2c0 = "/fragment@2:target:0\0/fragment@38:target:0";
		i2c1 = "/fragment@39:target:0";
		i2c2 = "/fragment@5:target:0\0/fragment@40:target:0";
		i2c3 = "/fragment@41:target:0";
		i2c4 = "/fragment@42:target:0";
		i2c5 = "/fragment@43:target:0";
		i2c6 = "/fragment@25:target:0\0/fragment@44:target:0";
		i2c7 = "/fragment@22:target:0\0/fragment@45:target:0";
		i2c8 = "/fragment@46:target:0";
		i2c9 = "/fragment@47:target:0";
		irq_nfc = "/fragment@52:target:0";
		kd_camera_hw1 = "/fragment@19:target:0\0/fragment@65:target:0";
		keypad = "/fragment@13:target:0\0/fragment@67:target:0";
		main_pmic = "/fragment@60:target:0";
		md1_sim1_hot_plug_eint = "/fragment@61:target:0";
		md1_sim2_hot_plug_eint = "/fragment@62:target:0";
		md_auxadc = "/fragment@36:target:0";
		mrdump_ext_rst = "/fragment@50:target:0";
		msdc1_ins = "/fragment@54:target:0";
		mt6360_pmu = "/fragment@10:target:0";
		mt6360_typec = "/fragment@11:target:0";
		mt_pmic_vcamio_ldo_reg = "/fragment@19/__overlay__:cam0_vcamio-supply:0\0/fragment@19/__overlay__:cam1_vcamio-supply:0\0/fragment@19/__overlay__:cam2_vcamio-supply:0\0/fragment@19/__overlay__:cam3_vcamio-supply:0\0/fragment@19/__overlay__:cam4_vcamio-supply:0\0/fragment@63:target:0\0/fragment@65/__overlay__:vcamio-supply:0\0/fragment@65/__overlay__:vcamio_sub-supply:0\0/fragment@65/__overlay__:vcamio_main2-supply:0\0/fragment@65/__overlay__:vcamio_sub2-supply:0\0/fragment@65/__overlay__:vcamio_main3-supply:0";
		mt_pmic_vtp_ldo_reg = "/fragment@2/__overlay__/gt9886@5d:vtouch-supply:0\0/fragment@64:target:0\0/fragment@66/__overlay__:vtouch-supply:0";
		mtkfb = "/fragment@9:target:0";
		odm = "/fragment@7:target:0\0/fragment@20:target:0";
		oppo_fp_common = "/fragment@34:target:0";
		pio = "/fragment@2/__overlay__/gt9886@5d:interrupt-parent:0\0/fragment@2/__overlay__/gt9886@5d:goodix,reset-gpio:0\0/fragment@2/__overlay__/gt9886@5d:goodix,irq-gpio:0\0/fragment@4:target:0\0/fragment@7/__overlay__/kpd_volume_up:interrupt-parent:0\0/fragment@7/__overlay__/kpd_volume_down:interrupt-parent:0\0/fragment@7/__overlay__/oppo_devinfo:nfc_board-gpio0:0\0/fragment@7/__overlay__/oppo_devinfo:nfc_board-gpio1:0\0/fragment@7/__overlay__/oppo_devinfo:nfc_board-gpio2:0\0/fragment@7/__overlay__/oppo_devinfo:sub_board-gpio:0\0/fragment@7/__overlay__/oppo_devinfo:sdcard-gpio:0\0/fragment@8:target:0\0/fragment@10/__overlay__:mt6360,intr_gpio:0\0/fragment@11/__overlay__:mt6360pd,intr_gpio:0\0/fragment@12:target:0\0/fragment@13/__overlay__:keypad,volume-up:0\0/fragment@13/__overlay__:keypad,volume-down:0\0/fragment@14:target:0\0/fragment@15:target:0\0/fragment@18:target:0\0/fragment@21/__overlay__:qcom,dischg-gpio:0\0/fragment@21/__overlay__:qcom,chargerid_switch-gpio:0\0/fragment@21/__overlay__:qcom,ship-gpio:0\0/fragment@22/__overlay__/stm8s_fastcg@26:qcom,charging_switch1-gpio:0\0/fragment@22/__overlay__/stm8s_fastcg@26:qcom,charging_reset-gpio:0\0/fragment@22/__overlay__/stm8s_fastcg@26:qcom,charging_clock-gpio:0\0/fragment@22/__overlay__/stm8s_fastcg@26:qcom,charging_data-gpio:0\0/fragment@23:target:0\0/fragment@24:target:0\0/fragment@25/__overlay__/aw87339@58:reset-gpio:0\0/fragment@27:target:0\0/fragment@28:target:0\0/fragment@29/__overlay__:fpc,irq-gpio:0\0/fragment@29/__overlay__:fpc,reset-gpio:0\0/fragment@29/__overlay__:fpc,vdd-en:0\0/fragment@29/__overlay__:fpc,gpio_cs:0\0/fragment@30:target:0\0/fragment@31/__overlay__:interrupt-parent:0\0/fragment@31/__overlay__:goodix,gpio_irq:0\0/fragment@31/__overlay__:goodix,gpio_reset:0\0/fragment@33:target:0\0/fragment@34/__overlay__:oppo,fp-id0:0\0/fragment@48/__overlay__:GPIO_FDD_BAND_SUPPORT_DETECT_4TH_PIN:0\0/fragment@48/__overlay__:GPIO_FDD_BAND_SUPPORT_DETECT_3RD_PIN:0\0/fragment@48/__overlay__:GPIO_FDD_BAND_SUPPORT_DETECT_1ST_PIN:0\0/fragment@48/__overlay__:GPIO_FDD_BAND_SUPPORT_DETECT_2ND_PIN:0\0/fragment@48/__overlay__:GPIO_SIM1_SIO:0\0/fragment@48/__overlay__:GPIO_SIM1_SRST:0\0/fragment@48/__overlay__:GPIO_SIM1_SCLK:0\0/fragment@48/__overlay__:GPIO_SIM2_SCLK:0\0/fragment@48/__overlay__:GPIO_SIM2_SRST:0\0/fragment@48/__overlay__:GPIO_SIM2_SIO:0\0/fragment@48/__overlay__:GPIO_SIM1_HOT_PLUG:0\0/fragment@48/__overlay__:GPIO_SIM2_HOT_PLUG:0\0/fragment@50/__overlay__:interrupt-parent:0\0/fragment@50/__overlay__:deb-gpios:0\0/fragment@51/__overlay__:interrupt-parent:0\0/fragment@52/__overlay__:interrupt-parent:0\0/fragment@53/__overlay__:interrupt-parent:0\0/fragment@54/__overlay__:interrupt-parent:0\0/fragment@55/__overlay__:interrupt-parent:0\0/fragment@56/__overlay__:interrupt-parent:0\0/fragment@57/__overlay__:interrupt-parent:0\0/fragment@58/__overlay__:interrupt-parent:0\0/fragment@59/__overlay__:interrupt-parent:0\0/fragment@59/__overlay__:deb-gpios:0\0/fragment@60/__overlay__:interrupt-parent:0";
		pmic_clock_buffer_ctrl = "/fragment@37:target:0";
		reserved_memory = "/fragment@0:target:0";
		smart_pa = "/fragment@57:target:0";
		snd_audio_dsp = "/fragment@17:target:0";
		spi0 = "/fragment@32:target:0";
		subpmic_pmu_eint = "/fragment@55:target:0";
		swtp = "/fragment@59:target:0";
		tcpc_pd = "/fragment@53:target:0";
		touch = "/fragment@3:target:0\0/fragment@51:target:0\0/fragment@66:target:0";
	};

	__local_fixups__ {

		fragment@13 {

			__overlay__ {
				pinctrl-0 = <0x00>;
				pinctrl-1 = <0x00>;
			};
		};

		fragment@16 {

			__overlay__ {
				pinctrl-0 = <0x00>;
				pinctrl-1 = <0x00>;
				pinctrl-2 = <0x00>;
				pinctrl-3 = <0x00>;
			};
		};

		fragment@19 {

			__overlay__ {
				pinctrl-0 = <0x00>;
				pinctrl-1 = <0x00>;
				pinctrl-10 = <0x00>;
				pinctrl-11 = <0x00>;
				pinctrl-12 = <0x00>;
				pinctrl-13 = <0x00>;
				pinctrl-14 = <0x00>;
				pinctrl-15 = <0x00>;
				pinctrl-16 = <0x00>;
				pinctrl-17 = <0x00>;
				pinctrl-18 = <0x00>;
				pinctrl-19 = <0x00>;
				pinctrl-2 = <0x00>;
				pinctrl-20 = <0x00>;
				pinctrl-21 = <0x00>;
				pinctrl-22 = <0x00>;
				pinctrl-23 = <0x00>;
				pinctrl-24 = <0x00>;
				pinctrl-25 = <0x00>;
				pinctrl-26 = <0x00>;
				pinctrl-27 = <0x00>;
				pinctrl-28 = <0x00>;
				pinctrl-29 = <0x00>;
				pinctrl-3 = <0x00>;
				pinctrl-30 = <0x00>;
				pinctrl-31 = <0x00>;
				pinctrl-32 = <0x00>;
				pinctrl-33 = <0x00>;
				pinctrl-34 = <0x00>;
				pinctrl-35 = <0x00>;
				pinctrl-36 = <0x00>;
				pinctrl-37 = <0x00>;
				pinctrl-38 = <0x00>;
				pinctrl-39 = <0x00>;
				pinctrl-4 = <0x00>;
				pinctrl-5 = <0x00>;
				pinctrl-6 = <0x00>;
				pinctrl-7 = <0x00>;
				pinctrl-8 = <0x00>;
				pinctrl-9 = <0x00>;
			};
		};

		fragment@2 {

			__overlay__ {
				pinctrl-0 = <0x00>;
				pinctrl-1 = <0x00>;
				pinctrl-2 = <0x00>;
				pinctrl-3 = <0x00>;
				pinctrl-4 = <0x00>;
			};
		};

		fragment@21 {

			__overlay__ {
				pinctrl-0 = <0x00>;
				pinctrl-1 = <0x00>;
				pinctrl-2 = <0x00>;
				pinctrl-3 = <0x00>;
				pinctrl-4 = <0x00>;
				pinctrl-5 = <0x00>;
			};
		};

		fragment@22 {

			__overlay__ {

				stm8s_fastcg@26 {
					pinctrl-0 = <0x00>;
					pinctrl-1 = <0x00>;
					pinctrl-10 = <0x00>;
					pinctrl-11 = <0x00>;
					pinctrl-2 = <0x00>;
					pinctrl-3 = <0x00>;
					pinctrl-4 = <0x00>;
					pinctrl-5 = <0x00>;
					pinctrl-6 = <0x00>;
					pinctrl-7 = <0x00>;
					pinctrl-8 = <0x00>;
					pinctrl-9 = <0x00>;
				};
			};
		};

		fragment@26 {

			__overlay__ {
				pinctrl-0 = <0x00>;
				pinctrl-1 = <0x00>;
				pinctrl-2 = <0x00>;
				pinctrl-3 = <0x00>;
				pinctrl-4 = <0x00>;
				pinctrl-5 = <0x00>;
				pinctrl-6 = <0x00>;
			};
		};

		fragment@29 {

			__overlay__ {
				pinctrl-0 = <0x00 0x04 0x08>;
				pinctrl-1 = <0x00>;
			};
		};

		fragment@3 {

			__overlay__ {
				pinctrl-0 = <0x00>;
				pinctrl-1 = <0x00>;
				pinctrl-2 = <0x00>;
				pinctrl-3 = <0x00>;
				pinctrl-4 = <0x00>;
				pinctrl-5 = <0x00>;
			};
		};

		fragment@31 {

			__overlay__ {
				pinctrl-0 = <0x00>;
				pinctrl-1 = <0x00>;
				pinctrl-2 = <0x00>;
			};
		};

		fragment@34 {

			__overlay__ {
				pinctrl-0 = <0x00>;
				pinctrl-1 = <0x00>;
				pinctrl-2 = <0x00>;
			};
		};

		fragment@7 {

			__overlay__ {

				usb_c_pinctrl {
					pinctrl-0 = <0x00>;
					pinctrl-1 = <0x00>;
					pinctrl-10 = <0x00>;
					pinctrl-11 = <0x00>;
					pinctrl-12 = <0x00>;
					pinctrl-2 = <0x00>;
					pinctrl-3 = <0x00>;
					pinctrl-4 = <0x00>;
					pinctrl-5 = <0x00>;
					pinctrl-6 = <0x00>;
					pinctrl-7 = <0x00>;
					pinctrl-8 = <0x00>;
					pinctrl-9 = <0x00>;
				};
			};
		};

		fragment@9 {

			__overlay__ {
				pinctrl-0 = <0x00>;
				pinctrl-1 = <0x00>;
				pinctrl-2 = <0x00>;
				pinctrl-3 = <0x00>;
				pinctrl-4 = <0x00>;
				pinctrl-5 = <0x00>;
				pinctrl-6 = <0x00>;
			};
		};
	};

	__symbols__ {
		camera0_mclk_2ma = "/fragment@18/__overlay__/camera0_mclk_2ma@gpio117";
		camera0_mclk_4ma = "/fragment@18/__overlay__/camera0_mclk_4ma@gpio117";
		camera0_mclk_6ma = "/fragment@18/__overlay__/camera0_mclk_6ma@gpio117";
		camera0_mclk_8ma = "/fragment@18/__overlay__/camera0_mclk_8ma@gpio117";
		camera0_mclk_off = "/fragment@18/__overlay__/camera0_mclk_gpio_mode@gpio117";
		camera0_rst_high = "/fragment@18/__overlay__/camera0_rst_output_high@gpio119";
		camera0_rst_low = "/fragment@18/__overlay__/camera0_rst_output_low@gpio119";
		camera0_vcamd_off = "/fragment@18/__overlay__/camera0_vcamd_output_low@gpio123";
		camera0_vcamd_on = "/fragment@18/__overlay__/camera0_vcamd_output_high@gpio123";
		camera1_mclk_2ma = "/fragment@18/__overlay__/camera1_mclk_2ma@gpio196";
		camera1_mclk_4ma = "/fragment@18/__overlay__/camera1_mclk_4ma@gpio196";
		camera1_mclk_6ma = "/fragment@18/__overlay__/camera1_mclk_6ma@gpio196";
		camera1_mclk_8ma = "/fragment@18/__overlay__/camera1_mclk_8ma@gpio196";
		camera1_mclk_off = "/fragment@18/__overlay__/camera1_mclk_gpio_mode@gpio196";
		camera1_rst_high = "/fragment@18/__overlay__/camera1_rst_output_high@gpio124";
		camera1_rst_low = "/fragment@18/__overlay__/camera1_rst_output_low@gpio124";
		camera2_mclk_2ma = "/fragment@18/__overlay__/camera2_mclk_2ma@gpio120";
		camera2_mclk_4ma = "/fragment@18/__overlay__/camera2_mclk_4ma@gpio120";
		camera2_mclk_6ma = "/fragment@18/__overlay__/camera2_mclk_6ma@gpio120";
		camera2_mclk_8ma = "/fragment@18/__overlay__/camera2_mclk_8ma@gpio120";
		camera2_mclk_off = "/fragment@18/__overlay__/camera2_mclk_gpio_mode@gpio120";
		camera2_rst_high = "/fragment@18/__overlay__/camera2_rst_output_high@gpio197";
		camera2_rst_low = "/fragment@18/__overlay__/camera2_rst_output_low@gpio197";
		camera3_mclk_2ma = "/fragment@18/__overlay__/camera3_mclk_2ma@gpio121";
		camera3_mclk_4ma = "/fragment@18/__overlay__/camera3_mclk_4ma@gpio121";
		camera3_mclk_6ma = "/fragment@18/__overlay__/camera3_mclk_6ma@gpio121";
		camera3_mclk_8ma = "/fragment@18/__overlay__/camera3_mclk_8ma@gpio121";
		camera3_mclk_off = "/fragment@18/__overlay__/camera3_mclk_gpio_mode@gpio121";
		camera3_pnd_high = "/fragment@18/__overlay__/camera3_pnd_output_high@gpio125";
		camera3_pnd_low = "/fragment@18/__overlay__/camera3_pnd_output_low@gpio125";
		camera4_mclk_2ma = "/fragment@18/__overlay__/camera4_mclk_2ma@gpio116";
		camera4_mclk_4ma = "/fragment@18/__overlay__/camera4_mclk_4ma@gpio116";
		camera4_mclk_6ma = "/fragment@18/__overlay__/camera4_mclk_6ma@gpio116";
		camera4_mclk_8ma = "/fragment@18/__overlay__/camera4_mclk_8ma@gpio116";
		camera4_mclk_off = "/fragment@18/__overlay__/camera4_mclk_gpio_mode@gpio116";
		camera4_pnd_high = "/fragment@18/__overlay__/camera4_pnd_output_high@gpio118";
		camera4_pnd_low = "/fragment@18/__overlay__/camera4_pnd_output_low@gpio118";
		camera_main_af_mtk = "/fragment@40/__overlay__/camera_main_af@0c";
		camera_main_eeprom_mtk = "/fragment@40/__overlay__/camera_main_eeprom@50";
		camera_main_mtk = "/fragment@40/__overlay__/camera_main@1a";
		camera_main_two_af_mtk = "/fragment@42/__overlay__/camera_main_two_af@0c";
		camera_main_two_eeprom_mtk = "/fragment@42/__overlay__/camera_main_two_eeprom@50";
		camera_main_two_mtk = "/fragment@42/__overlay__/camera_main_two@10";
		camera_mipi_switch_high = "/fragment@18/__overlay__/camera_mipi_switch_high@gpio72";
		camera_mipi_switch_low = "/fragment@18/__overlay__/camera_mipi_switch_low@gpio72";
		camera_pins_default = "/fragment@18/__overlay__/camdefault";
		camera_sub_eeprom_mtk = "/fragment@42/__overlay__/camera_sub_eeprom@52";
		camera_sub_mtk = "/fragment@42/__overlay__/camera_sub@2d";
		cap_touch_mtk = "/fragment@38/__overlay__/cap_touch@14";
		ccu_sensor_i2c_2_hw_mtk = "/fragment@40/__overlay__/ccu_sensor_i2c_2_hw@33";
		ccu_sensor_i2c_4_hw_mtk = "/fragment@42/__overlay__/ccu_sensor_i2c_4_hw@36";
		ccu_sensor_i2c_7_hw_mtk = "/fragment@45/__overlay__/ccu_sensor_i2c_7_hw@43";
		charger_pins_eint_output0 = "/fragment@23/__overlay__/charger_gpio_as_output_low";
		charger_pins_eint_output1 = "/fragment@23/__overlay__/charger_gpio_as_output_high";
		charging_clock_active = "/fragment@24/__overlay__/charging_clock_active";
		charging_clock_sleep = "/fragment@24/__overlay__/charging_clock_sleep";
		charging_data_active = "/fragment@24/__overlay__/charging_data_active";
		charging_data_sleep = "/fragment@24/__overlay__/charging_data_sleep";
		charging_disable_gpio = "/fragment@23/__overlay__/dischg_enable";
		charging_enable_gpio = "/fragment@23/__overlay__/dischg_disable";
		charging_reset_active = "/fragment@24/__overlay__/charging_reset_active";
		charging_reset_sleep = "/fragment@24/__overlay__/charging_reset_sleep";
		charging_switch1_active = "/fragment@24/__overlay__/charging_switch1_active";
		charging_switch1_sleep = "/fragment@24/__overlay__/charging_switch1_sleep";
		consys_pins_default = "/fragment@15/__overlay__/consys_default";
		ctp_pins_default = "/fragment@4/__overlay__/eint0default";
		ctp_pins_eint_as_int = "/fragment@4/__overlay__/eint@0";
		ctp_pins_eint_output0 = "/fragment@4/__overlay__/eintoutput0";
		ctp_pins_eint_output1 = "/fragment@4/__overlay__/eintoutput1";
		ctp_pins_rst_output0 = "/fragment@4/__overlay__/rstoutput0";
		ctp_pins_rst_output1 = "/fragment@4/__overlay__/rstoutput1";
		ctp_ts_int_active = "/fragment@4/__overlay__/int_active";
		ctp_ts_int_suspend = "/fragment@4/__overlay__/int_suspend";
		ctp_ts_pins_default = "/fragment@4/__overlay__/eint1default";
		ctp_ts_reset_active = "/fragment@4/__overlay__/reset_active";
		ctp_ts_reset_suspend = "/fragment@4/__overlay__/reset_suspend";
		fpc_irq_default = "/fragment@28/__overlay__/fpc_irq_default";
		fpc_pwr_default = "/fragment@28/__overlay__/fpc_pwr_default";
		fpc_reset_default = "/fragment@28/__overlay__/fpc_reset_default";
		goodix_irq_no_pull = "/fragment@30/__overlay__/goodix_irq_no_pull";
		goodix_irq_out_low = "/fragment@30/__overlay__/goodix_irq_out_low";
		goodix_reset_default = "/fragment@30/__overlay__/goodix_reset_default";
		gpio_fpc_cs_func = "/fragment@28/__overlay__/gpio_fpc_cs_func";
		gpio_id0_default = "/fragment@33/__overlay__/gpio_id0_default";
		gpio_id0_pull_down = "/fragment@33/__overlay__/gpio_id0_pull_down";
		gpio_id0_pull_up = "/fragment@33/__overlay__/gpio_id0_pull_up";
		gpio_redriver_c1_high = "/fragment@12/__overlay__/c1_high";
		gpio_redriver_c1_hiz = "/fragment@12/__overlay__/c1_highz";
		gpio_redriver_c1_init = "/fragment@12/__overlay__/c1_init";
		gpio_redriver_c1_low = "/fragment@12/__overlay__/c1_low";
		gpio_redriver_c2_high = "/fragment@12/__overlay__/c2_high";
		gpio_redriver_c2_hiz = "/fragment@12/__overlay__/c2_highz";
		gpio_redriver_c2_init = "/fragment@12/__overlay__/c2_init";
		gpio_redriver_c2_low = "/fragment@12/__overlay__/c2_low";
		gpio_u3_switch_disable = "/fragment@12/__overlay__/u3_sw_dis";
		gpio_u3_switch_enable = "/fragment@12/__overlay__/u3_sw_en";
		gpio_u3_switch_sel1 = "/fragment@12/__overlay__/u3_sw_sel1";
		gpio_u3_switch_sel2 = "/fragment@12/__overlay__/u3_sw_sel2";
		gpslna_pins_init = "/fragment@15/__overlay__/gpslna@0";
		gpslna_pins_oh = "/fragment@15/__overlay__/gpslna@1";
		gpslna_pins_ol = "/fragment@15/__overlay__/gpslna@2";
		kpd_volume_down = "/fragment@7/__overlay__/kpd_volume_down";
		kpd_volume_up = "/fragment@7/__overlay__/kpd_volume_up";
		led0 = "/fragment@7/__overlay__/led@0";
		led1 = "/fragment@7/__overlay__/led@1";
		led2 = "/fragment@7/__overlay__/led@2";
		led3 = "/fragment@7/__overlay__/led@3";
		led4 = "/fragment@7/__overlay__/led@4";
		led5 = "/fragment@7/__overlay__/led@5";
		led6 = "/fragment@7/__overlay__/led@6";
		memory_ssmr_features = "/fragment@7/__overlay__/memory-ssmr-features";
		mtkfb_pins_lcd_bias_enn0 = "/fragment@8/__overlay__/lcd_bias_enn0_gpio";
		mtkfb_pins_lcd_bias_enn1 = "/fragment@8/__overlay__/lcd_bias_enn1_gpio";
		mtkfb_pins_lcd_bias_enp0 = "/fragment@8/__overlay__/lcd_bias_enp0_gpio";
		mtkfb_pins_lcd_bias_enp1 = "/fragment@8/__overlay__/lcd_bias_enp1_gpio";
		mtkfb_pins_lcm_dsi_te = "/fragment@8/__overlay__/lcm_dsi_te";
		mtkfb_pins_lcm_rst_out0_gpio = "/fragment@8/__overlay__/lcm_rst_out0_gpio";
		mtkfb_pins_lcm_rst_out1_gpio = "/fragment@8/__overlay__/lcm_rst_out1_gpio";
		nfc_mtk = "/fragment@41/__overlay__/nfc@08";
		oppo_devinfo = "/fragment@7/__overlay__/oppo_devinfo";
		oppo_fp = "/fragment@32/__overlay__/fingerprint@0";
		oppo_project = "/fragment@7/__overlay__/oppo_project";
		oppo_sensor = "/fragment@7/__overlay__/oppo_sensor";
		ship_active_gpio = "/fragment@23/__overlay__/ship_active";
		ship_sleep_gpio = "/fragment@23/__overlay__/ship_sleep";
		speaker_amp_mtk = "/fragment@44/__overlay__/speaker_amp@34";
		subpmic_ldo_mtk = "/fragment@43/__overlay__/subpmic_ldo@64";
		subpmic_mtk = "/fragment@43/__overlay__/subpmic@34";
		subpmic_pmic_mtk = "/fragment@43/__overlay__/subpmic_pmic@1a";
		uart0_pins_default = "/fragment@27/__overlay__/uart0default";
		uart0_rx_gpio_input = "/fragment@27/__overlay__/uart0_rx_gpio@gpio53";
		uart0_rx_output0 = "/fragment@27/__overlay__/rxoutput0";
		uart0_rx_output1 = "/fragment@27/__overlay__/rxoutput1";
		uart0_tx_gpio_input = "/fragment@27/__overlay__/uart0_tx_gpio@gpio54";
		uart0_tx_output0 = "/fragment@27/__overlay__/txoutput0";
		uart0_tx_output1 = "/fragment@27/__overlay__/txoutput1";
		usb_c_pinctrl = "/fragment@7/__overlay__/usb_c_pinctrl";
		usb_default = "/fragment@12/__overlay__/usb_default";
		usb_type_c_mtk = "/fragment@43/__overlay__/usb_type_c@4e";
		vibrator0 = "/fragment@7/__overlay__/vibrator@0";
		volume_down_gpio_eint = "/fragment@14/__overlay__/volume_down@0";
		volume_up_gpio_eint = "/fragment@14/__overlay__/volume_up@0";
		vooc_ap_data = "/fragment@20/__overlay__/vooc_ap_data";
		vooc_ap_data_new_function = "/fragment@20/__overlay__/vooc_ap_data_new_function";
		vproc_buck_mtk = "/fragment@47/__overlay__/vproc_buck@6b";
	};

	fragment@0 {
		target = <0xffffffff>;

		__overlay__ {
			#address-cells = <0x02>;
			#size-cells = <0x02>;
			ranges;

			zmc-default {
				alignment = <0x00 0x1000000>;
				alloc-ranges = <0x00 0xc0000000 0x04 0x00>;
				compatible = "mediatek,zone_movable_cma";
				size = <0x00 0x1c000000>;
			};
		};
	};

	fragment@1 {
		target = <0xffffffff>;

		__overlay__ {
			atag,videolfb-fb_base_h = <0x00>;
			atag,videolfb-fb_base_l = "~`P";
			atag,videolfb-fps = <0x1770>;
			atag,videolfb-islcm_inited = <0x00>;
			atag,videolfb-islcmfound = <0x01>;
			atag,videolfb-lcmname = "nt35695_fhd_dsi_cmd_truly_rt5081_drv";
			atag,videolfb-vramSize = <0x17e8000>;
		};
	};

	fragment@10 {
		target = <0xffffffff>;

		__overlay__ {
			mt6360,intr_gpio = <0xffffffff 0x10 0x00>;
			mt6360,intr_gpio_num = <0x10>;
		};
	};

	fragment@11 {
		target = <0xffffffff>;

		__overlay__ {
			mt6360pd,intr_gpio = <0xffffffff 0x07 0x00>;
			mt6360pd,intr_gpio_num = <0x07>;
		};
	};

	fragment@12 {
		target = <0xffffffff>;

		__overlay__ {

			c1_high {
				phandle = <0x10>;

				pins_cmd_dat {
					output-high;
					pinmux = <0x2800>;
					slew-rate = <0x01>;
				};
			};

			c1_highz {
				phandle = <0x0f>;

				pins_cmd_dat {
					bias-disable;
					pinmux = <0x2800>;
					slew-rate = <0x00>;
				};
			};

			c1_init {
				phandle = <0x0d>;

				pins_cmd_dat {
					output-low;
					pinmux = <0x2800>;
					slew-rate = <0x01>;
				};
			};

			c1_low {
				phandle = <0x0e>;

				pins_cmd_dat {
					output-low;
					pinmux = <0x2800>;
					slew-rate = <0x01>;
				};
			};

			c2_high {
				phandle = <0x14>;

				pins_cmd_dat {
					output-high;
					pinmux = <0x1e00>;
					slew-rate = <0x01>;
				};
			};

			c2_highz {
				phandle = <0x13>;

				pins_cmd_dat {
					bias-disable;
					pinmux = <0x1e00>;
					slew-rate = <0x00>;
				};
			};

			c2_init {
				phandle = <0x11>;

				pins_cmd_dat {
					output-low;
					pinmux = <0x1e00>;
					slew-rate = <0x01>;
				};
			};

			c2_low {
				phandle = <0x12>;

				pins_cmd_dat {
					output-low;
					pinmux = <0x1e00>;
					slew-rate = <0x01>;
				};
			};

			u3_sw_dis {
				phandle = <0x18>;
			};

			u3_sw_en {
				phandle = <0x17>;
			};

			u3_sw_sel1 {
				phandle = <0x15>;

				pins_cmd_dat {
					output-low;
					pinmux = <0x2000>;
					slew-rate = <0x01>;
				};
			};

			u3_sw_sel2 {
				phandle = <0x16>;

				pins_cmd_dat {
					output-high;
					pinmux = <0x2000>;
					slew-rate = <0x01>;
				};
			};

			usb_default {
				phandle = <0x0c>;
			};
		};
	};

	fragment@13 {
		target = <0xffffffff>;

		__overlay__ {
			keypad,volume-down = <0xffffffff 0x3c 0x00>;
			keypad,volume-up = <0xffffffff 0x3b 0x00>;
			pinctrl-0 = <0x20>;
			pinctrl-1 = <0x21>;
			pinctrl-names = "volume_up_as_int\0volume_down_as_int";
			status = "okay";
		};
	};

	fragment@14 {
		target = <0xffffffff>;

		__overlay__ {

			volume_down@0 {
				phandle = <0x21>;

				pins_cmd_dat {
					bias-pull-up = <0x00>;
					input-enable;
					pinmux = <0x3c00>;
					slew-rate = <0x00>;
				};
			};

			volume_up@0 {
				phandle = <0x20>;

				pins_cmd_dat {
					bias-pull-up = <0x00>;
					input-enable;
					pinmux = <0x3b00>;
					slew-rate = <0x00>;
				};
			};
		};
	};

	fragment@15 {
		target = <0xffffffff>;

		__overlay__ {

			consys_default {
				phandle = <0x22>;
			};

			gpslna@0 {
				phandle = <0x23>;

				pins_cmd_dat {
					bias-disable;
					output-low;
					pinmux = <0x9b00>;
					slew-rate = <0x01>;
				};
			};

			gpslna@1 {
				phandle = <0x24>;

				pins_cmd_dat {
					output-high;
					pinmux = <0x9b00>;
					slew-rate = <0x01>;
				};
			};

			gpslna@2 {
				phandle = <0x25>;

				pins_cmd_dat {
					output-low;
					pinmux = <0x9b00>;
					slew-rate = <0x01>;
				};
			};
		};
	};

	fragment@16 {
		target = <0xffffffff>;

		__overlay__ {
			pinctrl-0 = <0x22>;
			pinctrl-1 = <0x23>;
			pinctrl-2 = <0x24>;
			pinctrl-3 = <0x25>;
			pinctrl-names = "default\0gps_lna_state_init\0gps_lna_state_oh\0gps_lna_state_ol";
			status = "okay";
		};
	};

	fragment@17 {
		target = <0xffffffff>;

		__overlay__ {
			mtk_dsp_a2dp = <0x00 0xffffffff 0xffffffff 0xffffffff>;
			mtk_dsp_call_final = <0x01 0x04 0x0f 0x13>;
			mtk_dsp_capture1 = <0x00 0xffffffff 0x0c 0x12>;
			mtk_dsp_dataprovider = <0x00 0xffffffff 0x0f 0xffffffff>;
			mtk_dsp_deep = <0x00 0x03 0xffffffff 0xffffffff>;
			mtk_dsp_ktv = <0x01 0x08 0x11 0xffffffff>;
			mtk_dsp_offload = <0x00 0x06 0xffffffff 0xffffffff>;
			mtk_dsp_playback = <0x01 0x04 0x0f 0x13>;
			mtk_dsp_primary = <0x00 0x00 0xffffffff 0xffffffff>;
			mtk_dsp_voip = <0x00 0x01 0xffffffff 0xffffffff>;
			swdsp_smartpa_process_enable = <0x01>;
		};
	};

	fragment@18 {
		target = <0xffffffff>;

		__overlay__ {

			camdefault {
				phandle = <0x26>;
			};

			camera0_mclk_2ma@gpio117 {
				phandle = <0x34>;

				pins_cmd_dat {
					drive-strength = <0x00>;
					pinmux = <0x7501>;
				};
			};

			camera0_mclk_4ma@gpio117 {
				phandle = <0x35>;

				pins_cmd_dat {
					drive-strength = <0x01>;
					pinmux = <0x7501>;
				};
			};

			camera0_mclk_6ma@gpio117 {
				phandle = <0x36>;

				pins_cmd_dat {
					drive-strength = <0x02>;
					pinmux = <0x7501>;
				};
			};

			camera0_mclk_8ma@gpio117 {
				phandle = <0x37>;

				pins_cmd_dat {
					drive-strength = <0x03>;
					pinmux = <0x7501>;
				};
			};

			camera0_mclk_gpio_mode@gpio117 {
				phandle = <0x33>;

				pins_cmd_dat {
					drive-strength = <0x01>;
					pinmux = <0x7500>;
				};
			};

			camera0_rst_output_high@gpio119 {
				phandle = <0x28>;

				pins_cmd_dat {
					output-high;
					pinmux = <0x7700>;
				};
			};

			camera0_rst_output_low@gpio119 {
				phandle = <0x27>;

				pins_cmd_dat {
					output-low;
					pinmux = <0x7700>;
				};
			};

			camera0_vcamd_output_high@gpio123 {
				phandle = <0x2a>;

				pins_cmd_dat {
					output-high;
					pinmux = <0x7b00>;
				};
			};

			camera0_vcamd_output_low@gpio123 {
				phandle = <0x29>;

				pins_cmd_dat {
					output-low;
					pinmux = <0x7b00>;
					slew-rate = <0x01>;
				};
			};

			camera1_mclk_2ma@gpio196 {
				phandle = <0x39>;

				pins_cmd_dat {
					drive-strength = <0x00>;
					pinmux = <0xc401>;
				};
			};

			camera1_mclk_4ma@gpio196 {
				phandle = <0x3a>;

				pins_cmd_dat {
					drive-strength = <0x01>;
					pinmux = <0xc401>;
				};
			};

			camera1_mclk_6ma@gpio196 {
				phandle = <0x3b>;

				pins_cmd_dat {
					drive-strength = <0x02>;
					pinmux = <0xc401>;
				};
			};

			camera1_mclk_8ma@gpio196 {
				phandle = <0x3c>;

				pins_cmd_dat {
					drive-strength = <0x03>;
					pinmux = <0xc401>;
				};
			};

			camera1_mclk_gpio_mode@gpio196 {
				phandle = <0x38>;

				pins_cmd_dat {
					drive-strength = <0x01>;
					pinmux = <0xc400>;
				};
			};

			camera1_rst_output_high@gpio124 {
				phandle = <0x2c>;

				pins_cmd_dat {
					output-high;
					pinmux = <0x7c00>;
				};
			};

			camera1_rst_output_low@gpio124 {
				phandle = <0x2b>;

				pins_cmd_dat {
					output-low;
					pinmux = <0x7c00>;
				};
			};

			camera2_mclk_2ma@gpio120 {
				phandle = <0x3e>;

				pins_cmd_dat {
					drive-strength = <0x00>;
					pinmux = <0x7801>;
				};
			};

			camera2_mclk_4ma@gpio120 {
				phandle = <0x3f>;

				pins_cmd_dat {
					drive-strength = <0x01>;
					pinmux = <0x7801>;
				};
			};

			camera2_mclk_6ma@gpio120 {
				phandle = <0x40>;

				pins_cmd_dat {
					drive-strength = <0x02>;
					pinmux = <0x7801>;
				};
			};

			camera2_mclk_8ma@gpio120 {
				phandle = <0x41>;

				pins_cmd_dat {
					drive-strength = <0x03>;
					pinmux = <0x7801>;
				};
			};

			camera2_mclk_gpio_mode@gpio120 {
				phandle = <0x3d>;

				pins_cmd_dat {
					drive-strength = <0x01>;
					pinmux = <0x7800>;
				};
			};

			camera2_rst_output_high@gpio197 {
				phandle = <0x2e>;

				pins_cmd_dat {
					output-high;
					pinmux = <0xc500>;
				};
			};

			camera2_rst_output_low@gpio197 {
				phandle = <0x2d>;

				pins_cmd_dat {
					output-low;
					pinmux = <0xc500>;
				};
			};

			camera3_mclk_2ma@gpio121 {
				phandle = <0x43>;

				pins_cmd_dat {
					drive-strength = <0x00>;
					pinmux = <0x7901>;
				};
			};

			camera3_mclk_4ma@gpio121 {
				phandle = <0x44>;

				pins_cmd_dat {
					drive-strength = <0x01>;
					pinmux = <0x7901>;
				};
			};

			camera3_mclk_6ma@gpio121 {
				phandle = <0x45>;

				pins_cmd_dat {
					drive-strength = <0x02>;
					pinmux = <0x7901>;
				};
			};

			camera3_mclk_8ma@gpio121 {
				phandle = <0x46>;

				pins_cmd_dat {
					drive-strength = <0x03>;
					pinmux = <0x7901>;
				};
			};

			camera3_mclk_gpio_mode@gpio121 {
				phandle = <0x42>;

				pins_cmd_dat {
					drive-strength = <0x01>;
					pinmux = <0x7900>;
				};
			};

			camera3_pnd_output_high@gpio125 {
				phandle = <0x30>;

				pins_cmd_dat {
					output-high;
					pinmux = <0x7d00>;
				};
			};

			camera3_pnd_output_low@gpio125 {
				phandle = <0x2f>;

				pins_cmd_dat {
					output-low;
					pinmux = <0x7d00>;
				};
			};

			camera4_mclk_2ma@gpio116 {
				phandle = <0x48>;

				pins_cmd_dat {
					drive-strength = <0x00>;
					pinmux = <0x7401>;
				};
			};

			camera4_mclk_4ma@gpio116 {
				phandle = <0x49>;

				pins_cmd_dat {
					drive-strength = <0x01>;
					pinmux = <0x7401>;
				};
			};

			camera4_mclk_6ma@gpio116 {
				phandle = <0x4a>;

				pins_cmd_dat {
					drive-strength = <0x02>;
					pinmux = <0x7401>;
				};
			};

			camera4_mclk_8ma@gpio116 {
				phandle = <0x4b>;

				pins_cmd_dat {
					drive-strength = <0x03>;
					pinmux = <0x7401>;
				};
			};

			camera4_mclk_gpio_mode@gpio116 {
				phandle = <0x47>;

				pins_cmd_dat {
					drive-strength = <0x01>;
					pinmux = <0x7400>;
				};
			};

			camera4_pnd_output_high@gpio118 {
				phandle = <0x32>;

				pins_cmd_dat {
					output-high;
					pinmux = <0x7600>;
				};
			};

			camera4_pnd_output_low@gpio118 {
				phandle = <0x31>;

				pins_cmd_dat {
					output-low;
					pinmux = <0x7600>;
				};
			};

			camera_mipi_switch_high@gpio72 {
				phandle = <0x4d>;

				pins_cmd_dat {
					output-high;
					pinmux = <0x4800>;
				};
			};

			camera_mipi_switch_low@gpio72 {
				phandle = <0x4c>;

				pins_cmd_dat {
					output-low;
					pinmux = <0x4800>;
				};
			};
		};
	};

	fragment@19 {
		target = <0xffffffff>;

		__overlay__ {
			cam0_enable_sensor = "s5kgw1_mipi_raw s5kgm1sp_mipi_raw";
			cam0_vcamio-supply = <0xffffffff>;
			cam1_enable_sensor = "s5k3p9sp_mipi_raw";
			cam1_vcamio-supply = <0xffffffff>;
			cam2_enable_sensor = "ov8856_mipi_raw";
			cam2_vcamio-supply = <0xffffffff>;
			cam3_enable_sensor = "gc2375h_mipi_raw gc02k0_mipi_raw";
			cam3_vcamio-supply = <0xffffffff>;
			cam4_enable_sensor = "gc02m0_mipi_mono";
			cam4_vcamio-supply = <0xffffffff>;
			pinctrl-0 = <0x26>;
			pinctrl-1 = <0x27>;
			pinctrl-10 = <0x30>;
			pinctrl-11 = <0x31>;
			pinctrl-12 = <0x32>;
			pinctrl-13 = <0x33>;
			pinctrl-14 = <0x34>;
			pinctrl-15 = <0x35>;
			pinctrl-16 = <0x36>;
			pinctrl-17 = <0x37>;
			pinctrl-18 = <0x38>;
			pinctrl-19 = <0x39>;
			pinctrl-2 = <0x28>;
			pinctrl-20 = <0x3a>;
			pinctrl-21 = <0x3b>;
			pinctrl-22 = <0x3c>;
			pinctrl-23 = <0x3d>;
			pinctrl-24 = <0x3e>;
			pinctrl-25 = <0x3f>;
			pinctrl-26 = <0x40>;
			pinctrl-27 = <0x41>;
			pinctrl-28 = <0x42>;
			pinctrl-29 = <0x43>;
			pinctrl-3 = <0x29>;
			pinctrl-30 = <0x44>;
			pinctrl-31 = <0x45>;
			pinctrl-32 = <0x46>;
			pinctrl-33 = <0x47>;
			pinctrl-34 = <0x48>;
			pinctrl-35 = <0x49>;
			pinctrl-36 = <0x4a>;
			pinctrl-37 = <0x4b>;
			pinctrl-38 = <0x4c>;
			pinctrl-39 = <0x4d>;
			pinctrl-4 = <0x2a>;
			pinctrl-5 = <0x2b>;
			pinctrl-6 = <0x2c>;
			pinctrl-7 = <0x2d>;
			pinctrl-8 = <0x2e>;
			pinctrl-9 = <0x2f>;
			pinctrl-names = "default\0cam0_rst0\0cam0_rst1\0cam0_ldo_vcamd_0\0cam0_ldo_vcamd_1\0cam1_rst0\0cam1_rst1\0cam2_rst0\0cam2_rst1\0cam3_pnd0\0cam3_pnd1\0cam4_pnd0\0cam4_pnd1\0cam0_mclk_off\0cam0_mclk_2mA\0cam0_mclk_4mA\0cam0_mclk_6mA\0cam0_mclk_8mA\0cam1_mclk_off\0cam1_mclk_2mA\0cam1_mclk_4mA\0cam1_mclk_6mA\0cam1_mclk_8mA\0cam2_mclk_off\0cam2_mclk_2mA\0cam2_mclk_4mA\0cam2_mclk_6mA\0cam2_mclk_8mA\0cam3_mclk_off\0cam3_mclk_2mA\0cam3_mclk_4mA\0cam3_mclk_6mA\0cam3_mclk_8mA\0cam4_mclk_off\0cam4_mclk_2mA\0cam4_mclk_4mA\0cam4_mclk_6mA\0cam4_mclk_8mA\0cam_mipi_switch_sel_0\0cam_mipi_switch_sel_1";
			status = "okay";
		};
	};

	fragment@2 {
		target = <0xffffffff>;

		__overlay__ {
			clock-frequency = <0x61a80>;
			pinctrl-0 = <0x01>;
			pinctrl-1 = <0x02>;
			pinctrl-2 = <0x03>;
			pinctrl-3 = <0x04>;
			pinctrl-4 = <0x05>;
			pinctrl-names = "default\0ts_int_active\0ts_reset_active\0ts_int_suspend\0ts_reset_suspend";
			status = "okay";

			gt9886@5d {
				compatible = "goodix,gt9886";
				goodix,config-version = "6785v99";
				goodix,firmware-version = "6785ae";
				goodix,irq-flags = <0x02>;
				goodix,irq-gpio = <0xffffffff 0x01 0x00>;
				goodix,key-of-pen = <0x14b 0x14c>;
				goodix,panel-key-map = <0x9e 0xac 0xd9>;
				goodix,panel-max-id = <0x0a>;
				goodix,panel-max-p = <0x100>;
				goodix,panel-max-w = <0x100>;
				goodix,panel-max-x = <0x438>;
				goodix,panel-max-y = <0x870>;
				goodix,pen-enable;
				goodix,power-off-delay-us = <0x1388>;
				goodix,power-on-delay-us = <0x2710>;
				goodix,reset-gpio = <0xffffffff 0x02 0x00>;
				goodix,x2x;
				goodix,y2y;
				interrupt-parent = <0xffffffff>;
				interrupts = <0x01 0x02 0x01 0x00>;
				reg = <0x5d>;
				status = "ok";
				vtouch-supply = <0xffffffff>;

				sensor0 {
					normal-cfg;
				};
			};
		};
	};

	fragment@20 {
		target = <0xffffffff>;

		__overlay__ {

			vooc_ap_data {
				compatible = "mediatek, VOOC_AP_DATA-eint";
				interrupts = <0x43 0x02 0x43 0x00>;
				phandle = <0x7c>;
			};

			vooc_ap_data_new_function {
				compatible = "mediatek, VOOC_EINT_NEW_FUNCTION";
				phandle = <0x7d>;
			};
		};
	};

	fragment@21 {
		target = <0xffffffff>;

		__overlay__ {
			io-channel-names = "chargerID-channel";
			io-channels = <0xffffffff 0x05>;
			pinctrl-0 = <0x4e>;
			pinctrl-1 = <0x4f>;
			pinctrl-2 = <0x50>;
			pinctrl-3 = <0x51>;
			pinctrl-4 = <0x52>;
			pinctrl-5 = <0x53>;
			pinctrl-names = "charger_gpio_as_output_low\0charger_gpio_as_output_high\0ship_sleep\0ship_active\0dischg_disable\0dischg_enable";
			qcom,batt_capacity_mah = <0x10cc>;
			qcom,charger_hv_thr = <0x16a8>;
			qcom,charger_lv_thr = <0xd48>;
			qcom,chargerid_switch-gpio = <0xffffffff 0xc3 0x00>;
			qcom,check_batt_full_by_sw;
			qcom,chg_ctrl_by_calling;
			qcom,chg_ctrl_by_camera;
			qcom,chg_ctrl_by_lcd;
			qcom,cold_bat_decidegc = <0x14>;
			qcom,cold_vfloat_over_sw_limit = <0xf8c>;
			qcom,cold_vfloat_sw_limit = <0xf5a>;
			qcom,cool_bat_decidegc = <0x32>;
			qcom,cool_vfloat_over_sw_limit = <0x1158>;
			qcom,cool_vfloat_sw_limit = <0x1121>;
			qcom,default_iterm_ma = <0xfa>;
			qcom,default_normal_vfloat_over_sw_limit = <0x1158>;
			qcom,default_normal_vfloat_sw_limit = <0x1121>;
			qcom,default_temp_normal_fastchg_current_ma = <0x898>;
			qcom,default_temp_normal_vfloat_mv = <0x1153>;
			qcom,dischg-gpio = <0xffffffff 0x0d 0x00>;
			qcom,external_gauge;
			qcom,ff1_exit_step_ma = <0x1e8>;
			qcom,ff1_normal_fastchg_ma = <0x5dc>;
			qcom,ff1_warm_exit_step_ma = <0x1a2>;
			qcom,ff1_warm_fastchg_ma = <0x5dc>;
			qcom,ffc2_exit_step_ma = <0xb4>;
			qcom,ffc2_normal_fastchg_ma = <0x44c>;
			qcom,ffc2_temp_high_decidegc = <0x190>;
			qcom,ffc2_temp_low_decidegc = <0x78>;
			qcom,ffc2_temp_warm_decidegc = <0x15e>;
			qcom,ffc2_warm_exit_step_ma = <0xaa>;
			qcom,ffc2_warm_fastchg_ma = <0x44c>;
			qcom,ffc_normal_vfloat_over_sw_limit = <0x1194>;
			qcom,ffc_normal_vfloat_sw_limit = <0x117b>;
			qcom,ffc_support;
			qcom,ffc_temp_normal_vfloat_mv = <0x1194>;
			qcom,hot_bat_decidegc = <0x212>;
			qcom,input_current_calling_ma = <0x5dc>;
			qcom,input_current_camera_ma = <0x4b0>;
			qcom,input_current_cdp_ma = <0x5dc>;
			qcom,input_current_charger_ma = <0x898>;
			qcom,input_current_led_ma = <0x4b0>;
			qcom,input_current_led_ma_forcmcc = <0x1f4>;
			qcom,input_current_led_ma_high = <0x1f4>;
			qcom,input_current_led_ma_limit_high = <0x4b0>;
			qcom,input_current_led_ma_normal = <0x7d0>;
			qcom,input_current_led_ma_warm = <0x5dc>;
			qcom,input_current_usb_ma = <0x1f4>;
			qcom,iterm_disabled = <0x00>;
			qcom,iterm_ma = <0xfa>;
			qcom,led_high_bat_decidegc = <0x1b8>;
			qcom,led_limit_high_bat_decidegc = <0x172>;
			qcom,led_warm_bat_decidegc = <0x15e>;
			qcom,little_cold_bat_decidegc = <0x00>;
			qcom,little_cold_vfloat_over_sw_limit = <0x1158>;
			qcom,little_cold_vfloat_sw_limit = <0x1121>;
			qcom,little_cool_bat_decidegc = <0x78>;
			qcom,little_cool_vfloat_over_sw_limit = <0x1158>;
			qcom,little_cool_vfloat_sw_limit = <0x1121>;
			qcom,max_chg_time_sec = <0x7530>;
			qcom,non_normal_vterm_hw_inc = <0x0a>;
			qcom,non_standard_fastchg_current_ma = <0x200>;
			qcom,non_standard_vfloat_mv = <0xf8c>;
			qcom,non_standard_vfloat_over_sw_limit = <0xf8c>;
			qcom,non_standard_vfloat_sw_limit = <0xf5a>;
			qcom,normal_bat_decidegc = <0xa0>;
			qcom,normal_vfloat_over_sw_limit = <0x1158>;
			qcom,normal_vfloat_sw_limit = <0x1121>;
			qcom,normal_vterm_hw_inc = <0x96>;
			qcom,pd_input_current_charger_ma = <0xce4>;
			qcom,pd_temp_normal_fastchg_current_ma = <0xce4>;
			qcom,recharge-mv = <0x73>;
			qcom,removed_bat_decidegc = <0xbe>;
			qcom,ship-gpio = <0xffffffff 0x1a 0x00>;
			qcom,short_c_bat_cv_mv = <0x10ea>;
			qcom,short_c_bat_fastchg_current_ma = <0x200>;
			qcom,short_c_bat_vfloat_mv = <0xed8>;
			qcom,short_c_bat_vfloat_sw_limit = <0xea6>;
			qcom,sw_vfloat_over_protect_enable;
			qcom,temp_cold_fastchg_current_ma = <0x168>;
			qcom,temp_cold_vfloat_mv = <0xf8c>;
			qcom,temp_cool_fastchg_current_ma_high = <0x898>;
			qcom,temp_cool_fastchg_current_ma_low = <0x7d0>;
			qcom,temp_cool_vfloat_mv = <0x1153>;
			qcom,temp_little_cold_fastchg_current_ma = <0x4b0>;
			qcom,temp_little_cold_fastchg_current_ma_high = <0x7d0>;
			qcom,temp_little_cold_fastchg_current_ma_low = <0x4b0>;
			qcom,temp_little_cold_vfloat_mv = <0x1153>;
			qcom,temp_little_cool_fastchg_current_ma = <0x898>;
			qcom,temp_little_cool_vfloat_mv = <0x1153>;
			qcom,temp_normal_fastchg_current_ma = <0x898>;
			qcom,temp_normal_vfloat_mv = <0x1153>;
			qcom,temp_warm_fastchg_current_ma = <0x4b0>;
			qcom,temp_warm_vfloat_mv = <0x1022>;
			qcom,vbatt_full_thr = <0x1130>;
			qcom,vbatt_hv_thr = <0x11c6>;
			qcom,vbatt_num = <0x01>;
			qcom,vbatt_power_off = <0xce4>;
			qcom,vbatt_soc_1 = <0xd52>;
			qcom,vfloat_step_mv = <0x10>;
			qcom,vooc_project = <0x01>;
			qcom,warm_bat_decidegc = <0x1b8>;
			qcom,warm_vfloat_over_sw_limit = <0x1022>;
			qcom,warm_vfloat_sw_limit = <0xff0>;
		};
	};

	fragment@22 {
		target = <0xffffffff>;

		__overlay__ {

			bq27541-battery@55 {
				compatible = "oppo,bq27541-battery";
				qcom,modify-soc-smooth;
				reg = <0x55 0x00>;
				status = "okay";
			};

			stm8s_fastcg@26 {
				compatible = "oppo,stm8s-fastcg";
				pinctrl-0 = <0x54>;
				pinctrl-1 = <0x55>;
				pinctrl-10 = <0x5a>;
				pinctrl-11 = <0x5b>;
				pinctrl-2 = <0x54>;
				pinctrl-3 = <0x55>;
				pinctrl-4 = <0x54>;
				pinctrl-5 = <0x55>;
				pinctrl-6 = <0x56>;
				pinctrl-7 = <0x57>;
				pinctrl-8 = <0x58>;
				pinctrl-9 = <0x59>;
				pinctrl-names = "switch1_act_switch2_act\0switch1_sleep_switch2_sleep\0switch1_act_switch3_act\0switch1_sleep_switch3_sleep\0switch1_act_switch2_sleep\0switch1_sleep_switch2_act\0clock_active\0clock_sleep\0data_active\0data_sleep\0reset_active\0reset_sleep";
				qcom,charging_clock-gpio = <0xffffffff 0x44 0x00>;
				qcom,charging_data-gpio = <0xffffffff 0x43 0x00>;
				qcom,charging_reset-gpio = <0xffffffff 0x0e 0x00>;
				qcom,charging_switch1-gpio = <0xffffffff 0x22 0x00>;
				qcom,oppo_batt_4400mv;
				qcom,vooc-fw-type = <0x07>;
				qcom,vooc-low-temp = <0x32>;
				qcom,vooc_fw_update_newmethod;
				qcom,vooc_multistep_adjust_current_support;
				qcom,vooc_multistep_initial_batt_temp = <0x3e8>;
				qcom,vooc_strategy1_batt_high_temp0 = <0x19a>;
				qcom,vooc_strategy1_batt_high_temp1 = <0x1a9>;
				qcom,vooc_strategy1_batt_high_temp2 = <0x1b3>;
				qcom,vooc_strategy1_batt_low_temp0 = <0x186>;
				qcom,vooc_strategy1_batt_low_temp1 = <0x19a>;
				qcom,vooc_strategy1_batt_low_temp2 = <0x1ae>;
				qcom,vooc_strategy1_high_current0 = <0x04>;
				qcom,vooc_strategy1_high_current1 = <0x03>;
				qcom,vooc_strategy1_high_current2 = <0x02>;
				qcom,vooc_strategy1_low_current0 = <0x06>;
				qcom,vooc_strategy1_low_current1 = <0x05>;
				qcom,vooc_strategy1_low_current2 = <0x03>;
				qcom,vooc_strategy2_batt_up_down_temp2 = <0x17c>;
				qcom,vooc_strategy2_batt_up_down_temp4 = <0x18b>;
				qcom,vooc_strategy2_batt_up_temp1 = <0x172>;
				qcom,vooc_strategy2_batt_up_temp3 = <0x186>;
				qcom,vooc_strategy2_batt_up_temp5 = <0x190>;
				qcom,vooc_strategy2_batt_up_temp6 = <0x19f>;
				qcom,vooc_strategy2_high0_current = <0x06>;
				qcom,vooc_strategy2_high1_current = <0x06>;
				qcom,vooc_strategy2_high2_current = <0x06>;
				qcom,vooc_strategy2_high3_current = <0x06>;
				qcom,vooc_strategy_normal_current = <0x06>;
				reg = <0x26 0x00>;
				status = "okay";
			};
		};
	};

	fragment@23 {
		target = <0xffffffff>;

		__overlay__ {

			charger_gpio_as_output_high {
				phandle = <0x4f>;

				pins_cmd_dat {
					output-high;
					pinmux = <0xc300>;
					slew-rate = <0x01>;
				};
			};

			charger_gpio_as_output_low {
				phandle = <0x4e>;

				pins_cmd_dat {
					output-low;
					pinmux = <0xc300>;
					slew-rate = <0x01>;
				};
			};

			dischg_disable {
				phandle = <0x52>;

				pins_cmd_dat {
					output-low;
					pinmux = <0xd00>;
					slew-rate = <0x01>;
				};
			};

			dischg_enable {
				phandle = <0x53>;

				pins_cmd_dat {
					output-high;
					pinmux = <0xd00>;
					slew-rate = <0x01>;
				};
			};

			ship_active {
				phandle = <0x51>;

				pins_cmd_dat {
					output-high;
					pinmux = <0x1a00>;
					slew-rate = <0x01>;
				};
			};

			ship_sleep {
				phandle = <0x50>;

				pins_cmd_dat {
					output-low;
					pinmux = <0x1a00>;
					slew-rate = <0x01>;
				};
			};
		};
	};

	fragment@24 {
		target = <0xffffffff>;

		__overlay__ {

			charging_clock_active {
				phandle = <0x56>;

				pins_cmd_dat {
					bias-pull-up = <0x00>;
					pinmux = <0x4400>;
					slew-rate = <0x00>;
				};
			};

			charging_clock_sleep {
				phandle = <0x57>;

				pins_cmd_dat {
					bias-pull-down = <0x00>;
					pinmux = <0x4400>;
					slew-rate = <0x00>;
				};
			};

			charging_data_active {
				phandle = <0x58>;

				pins_cmd_dat {
					bias-pull-up = <0x00>;
					pinmux = <0x4300>;
					slew-rate = <0x00>;
				};
			};

			charging_data_sleep {
				phandle = <0x59>;

				pins_cmd_dat {
					bias-pull-down = <0x00>;
					pinmux = <0x4300>;
					slew-rate = <0x00>;
				};
			};

			charging_reset_active {
				phandle = <0x5a>;

				pins_cmd_dat {
					output-high;
					pinmux = <0xe00>;
					slew-rate = <0x01>;
				};
			};

			charging_reset_sleep {
				phandle = <0x5b>;

				pins_cmd_dat {
					output-low;
					pinmux = <0xe00>;
					slew-rate = <0x01>;
				};
			};

			charging_switch1_active {
				phandle = <0x54>;

				pins_cmd_dat {
					output-high;
					pinmux = <0x2200>;
					slew-rate = <0x01>;
				};
			};

			charging_switch1_sleep {
				phandle = <0x55>;

				pins_cmd_dat {
					output-low;
					pinmux = <0x2200>;
					slew-rate = <0x01>;
				};
			};
		};
	};

	fragment@25 {
		target = <0xffffffff>;

		__overlay__ {

			aw87339@58 {
				compatible = "awinic,aw87339_pa";
				reg = <0x58>;
				reset-gpio = <0xffffffff 0x18 0x00>;
				status = "okay";
			};
		};
	};

	fragment@26 {
		target = <0xffffffff>;

		__overlay__ {
			pinctrl-0 = <0x5c>;
			pinctrl-1 = <0x5d>;
			pinctrl-2 = <0x5e>;
			pinctrl-3 = <0x5f>;
			pinctrl-4 = <0x60>;
			pinctrl-5 = <0x61>;
			pinctrl-6 = <0x62>;
			pinctrl-names = "uart0_rx_gpio\0uart0_tx_gpio\0default\0state_uart0_rx_output0\0state_uart0_rx_output1\0state_uart0_tx_output0\0state_uart0_tx_output1";
			status = "okay";
		};
	};

	fragment@27 {
		target = <0xffffffff>;

		__overlay__ {

			rxoutput0 {
				phandle = <0x5f>;

				pins_cmd_dat {
					output-low;
					pinmux = <0x3500>;
					slew-rate = <0x01>;
				};
			};

			rxoutput1 {
				phandle = <0x60>;

				pins_cmd_dat {
					output-high;
					pinmux = <0x3500>;
					slew-rate = <0x01>;
				};
			};

			txoutput0 {
				phandle = <0x61>;

				pins_cmd_dat {
					output-low;
					pinmux = <0x3600>;
					slew-rate = <0x01>;
				};
			};

			txoutput1 {
				phandle = <0x62>;

				pins_cmd_dat {
					output-high;
					pinmux = <0x3600>;
					slew-rate = <0x01>;
				};
			};

			uart0_rx_gpio@gpio53 {
				phandle = <0x5c>;

				pins_cmd_dat {
					bias-disable;
					input-enable;
					pinmux = <0x3500>;
					slew-rate = <0x00>;
				};
			};

			uart0_tx_gpio@gpio54 {
				phandle = <0x5d>;

				pins_cmd_dat {
					bias-disable;
					input-enable;
					pinmux = <0x3600>;
					slew-rate = <0x00>;
				};
			};

			uart0default {
				phandle = <0x5e>;
			};
		};
	};

	fragment@28 {
		target = <0xffffffff>;

		__overlay__ {

			fpc_irq_default {
				phandle = <0x64>;

				pins_cmd_dat {
					bias-pull-up = <0x00>;
					pinmux = <0x4b00>;
					slew-rate = <0x00>;
				};
			};

			fpc_pwr_default {
				phandle = <0x65>;

				pins_cmd_dat {
					bias-disable;
					output-low;
					pinmux = <0x9300>;
					slew-rate = <0x01>;
				};
			};

			fpc_reset_default {
				phandle = <0x63>;

				pins_cmd_dat {
					output-low;
					pinmux = <0x6900>;
					slew-rate = <0x01>;
				};
			};

			gpio_fpc_cs_func {
				phandle = <0x66>;

				pins_cmd_dat {
					drive-strength = <0x03>;
					pinmux = <0x1300>;
				};
			};
		};
	};

	fragment@29 {
		target = <0xffffffff>;

		__overlay__ {
			fpc,gpio_cs = <0xffffffff 0x13 0x00>;
			fpc,irq-gpio = <0xffffffff 0x4b 0x00>;
			fpc,reset-gpio = <0xffffffff 0x69 0x00>;
			fpc,vdd-en = <0xffffffff 0x93 0x00>;
			pinctrl-0 = <0x63 0x64 0x65>;
			pinctrl-1 = <0x66>;
			pinctrl-names = "default\0fpc_cs_func";
			status = "okay";
		};
	};

	fragment@3 {
		target = <0xffffffff>;

		__overlay__ {
			pinctrl-0 = <0x06>;
			pinctrl-1 = <0x07>;
			pinctrl-2 = <0x08>;
			pinctrl-3 = <0x09>;
			pinctrl-4 = <0x0a>;
			pinctrl-5 = <0x0b>;
			pinctrl-names = "default\0state_eint_as_int\0state_eint_output0\0state_eint_output1\0state_rst_output0\0state_rst_output1";
			status = "okay";
			tpd-filter-custom-prameters = <0x00 0x00 0x00 0x00 0x00 0x00 0x00 0x00 0x00 0x00 0x00 0x00>;
			tpd-filter-custom-speed = <0x00 0x00 0x00>;
			tpd-filter-enable = <0x01>;
			tpd-filter-pixel-density = <0xa8>;
			tpd-key-dim-local = <0x5a 0x373 0x64 0x28 0xe6 0x373 0x64 0x28 0x172 0x373 0x64 0x28 0x00 0x00 0x00 0x00>;
			tpd-key-local = <0x8b 0xac 0x9e 0x00>;
			tpd-key-num = <0x03>;
			tpd-max-touch-num = <0x0a>;
			tpd-resolution = <0x438 0x924>;
			use-tpd-button = <0x00>;
		};
	};

	fragment@30 {
		target = <0xffffffff>;

		__overlay__ {

			goodix_irq_no_pull {
				phandle = <0x69>;

				pins_cmd_dat {
					bias-disable;
					pinmux = <0x4b00>;
					slew-rate = <0x00>;
				};
			};

			goodix_irq_out_low {
				phandle = <0x68>;

				pins_cmd_dat {
					output-low;
					pinmux = <0x4b00>;
					slew-rate = <0x01>;
				};
			};

			goodix_reset_default {
				phandle = <0x67>;

				pins_cmd_dat {
					output-low;
					pinmux = <0x6900>;
					slew-rate = <0x01>;
				};
			};
		};
	};

	fragment@31 {
		target = <0xffffffff>;

		__overlay__ {
			goodix,gpio_irq = <0xffffffff 0x4b 0x00>;
			goodix,gpio_reset = <0xffffffff 0x69 0x00>;
			interrupt-parent = <0xffffffff>;
			interrupts = <0x4b 0x00>;
			pinctrl-0 = <0x67>;
			pinctrl-1 = <0x68>;
			pinctrl-2 = <0x69>;
			pinctrl-names = "goodix_reset_default\0goodix_irq_out_low\0goodix_irq_no_pull";
			spi-max-frequency = <0x7a1200>;
			status = "okay";
		};
	};

	fragment@32 {
		target = <0xffffffff>;

		__overlay__ {
			#address-cells = <0x01>;
			#size-cells = <0x00>;
			status = "okay";

			fingerprint@0 {
				compatible = "oppo,oppo_fp";
				phandle = <0x7e>;
				reg = <0x00>;
				spi-id = <0x00>;
				spi-irq = <0x4b>;
				spi-max-frequency = <0x7a1200>;
				spi-reg = <0xa7ffd0>;
				status = "okay";
			};
		};
	};

	fragment@33 {
		target = <0xffffffff>;

		__overlay__ {

			gpio_id0_default {
				phandle = <0x6a>;

				pins_cmd_dat {
					bias-pull-up = <0x00>;
					pinmux = <0x6a00>;
					slew-rate = <0x00>;
				};
			};

			gpio_id0_pull_down {
				phandle = <0x6c>;

				pins_cmd_dat {
					bias-pull-down = <0x00>;
					pinmux = <0x6a00>;
					slew-rate = <0x00>;
				};
			};

			gpio_id0_pull_up {
				phandle = <0x6b>;

				pins_cmd_dat {
					bias-pull-up = <0x00>;
					pinmux = <0x6a00>;
					slew-rate = <0x00>;
				};
			};
		};
	};

	fragment@34 {
		target = <0xffffffff>;

		__overlay__ {
			oppo,fp-id0 = <0xffffffff 0x6a 0x00>;
			pinctrl-0 = <0x6a>;
			pinctrl-1 = <0x6b>;
			pinctrl-2 = <0x6c>;
			pinctrl-names = "default\0gpio_id0_pull_up\0gpio_id0_pull_down";
		};
	};

	fragment@35 {
		target = <0xffffffff>;

		__overlay__ {

			adc_channel@ {
				compatible = "mediatek,adc_channel";
				mediatek,adc_fdd_rf_params_dynamic_custom_ch = <0x02>;
				mediatek,temperature0 = <0x00>;
				mediatek,temperature1 = <0x01>;
				status = "okay";
			};
		};
	};

	fragment@36 {
		target = <0xffffffff>;

		__overlay__ {
			io-channels = <0xffffffff 0x02>;
		};
	};

	fragment@37 {
		target = <0xffffffff>;

		__overlay__ {
			mediatek,clkbuf-config = <0x02 0x01 0x01 0x02 0x00 0x00 0x01>;
			mediatek,clkbuf-controls-for-desense = <0x00 0x04 0x00 0x03 0x00 0x00 0x00>;
			mediatek,clkbuf-output-impedance = <0x04 0x04 0x04 0x04 0x00 0x00 0x04>;
			mediatek,clkbuf-quantity = <0x07>;
			status = "okay";
		};
	};

	fragment@38 {
		target = <0xffffffff>;

		__overlay__ {
			#address-cells = <0x01>;
			#size-cells = <0x00>;
			clock-frequency = <0x61a80>;
			mediatek,use-open-drain;

			cap_touch@14 {
				compatible = "mediatek,cap_touch";
				phandle = <0x7f>;
				reg = <0x14>;
				status = "okay";
			};
		};
	};

	fragment@39 {
		target = <0xffffffff>;

		__overlay__ {
			#address-cells = <0x01>;
			#size-cells = <0x00>;
			clock-frequency = <0x61a80>;
			mediatek,use-open-drain;
		};
	};

	fragment@4 {
		target = <0xffffffff>;

		__overlay__ {

			eint0default {
				phandle = <0x06>;
			};

			eint1default {
				phandle = <0x01>;
			};

			eint@0 {
				phandle = <0x07>;

				pins_cmd_dat {
					bias-disable;
					pinmux = <0x100>;
					slew-rate = <0x00>;
				};
			};

			eintoutput0 {
				phandle = <0x08>;

				pins_cmd_dat {
					output-low;
					pinmux = <0x100>;
					slew-rate = <0x01>;
				};
			};

			eintoutput1 {
				phandle = <0x09>;

				pins_cmd_dat {
					output-high;
					pinmux = <0x100>;
					slew-rate = <0x01>;
				};
			};

			int_active {
				phandle = <0x02>;

				pins_cmd_dat {
					bias-pull-up = <0x0b>;
					pinmux = <0x100>;
					slew-rate = <0x00>;
				};
			};

			int_suspend {
				phandle = <0x04>;

				pins_cmd_dat {
					output-low;
					pinmux = <0x100>;
					slew-rate = <0x01>;
				};
			};

			reset_active {
				phandle = <0x03>;

				pins_cmd_dat {
					output-high;
					pinmux = <0x200>;
					slew-rate = <0x01>;
				};
			};

			reset_suspend {
				phandle = <0x05>;

				pins_cmd_dat {
					output-low;
					pinmux = <0x200>;
					slew-rate = <0x01>;
				};
			};

			rstoutput0 {
				phandle = <0x0a>;

				pins_cmd_dat {
					output-low;
					pinmux = <0x200>;
					slew-rate = <0x01>;
				};
			};

			rstoutput1 {
				phandle = <0x0b>;

				pins_cmd_dat {
					output-high;
					pinmux = <0x200>;
					slew-rate = <0x01>;
				};
			};
		};
	};

	fragment@40 {
		target = <0xffffffff>;

		__overlay__ {
			#address-cells = <0x01>;
			#size-cells = <0x00>;
			clock-frequency = <0x61a80>;
			mediatek,use-open-drain;

			camera_main@1a {
				compatible = "mediatek,camera_main";
				phandle = <0x80>;
				reg = <0x1a>;
				status = "okay";
			};

			camera_main_af@0c {
				compatible = "mediatek,camera_main_af";
				phandle = <0x81>;
				reg = <0x0c>;
				status = "okay";
			};

			camera_main_eeprom@50 {
				compatible = "mediatek,camera_main_eeprom";
				phandle = <0x82>;
				reg = <0x50>;
				status = "okay";
			};

			ccu_sensor_i2c_2_hw@33 {
				compatible = "mediatek,ccu_sensor_i2c_2_hw";
				phandle = <0x83>;
				reg = <0x33>;
				status = "okay";
			};
		};
	};

	fragment@41 {
		target = <0xffffffff>;

		__overlay__ {
			#address-cells = <0x01>;
			#size-cells = <0x00>;
			clock-frequency = <0x61a80>;
			mediatek,use-open-drain;

			nfc@08 {
				compatible = "mediatek,nfc";
				phandle = <0x84>;
				reg = <0x08>;
				status = "okay";
			};
		};
	};

	fragment@42 {
		target = <0xffffffff>;

		__overlay__ {
			#address-cells = <0x01>;
			#size-cells = <0x00>;
			clock-frequency = <0x61a80>;
			mediatek,use-open-drain;

			camera_main_two@10 {
				compatible = "mediatek,camera_main_two";
				phandle = <0x87>;
				reg = <0x10>;
				status = "okay";
			};

			camera_main_two_af@0c {
				compatible = "mediatek,camera_main_two_af";
				phandle = <0x88>;
				reg = <0x0c>;
				status = "okay";
			};

			camera_main_two_eeprom@50 {
				compatible = "mediatek,camera_main_two_eeprom";
				phandle = <0x89>;
				reg = <0x50>;
				status = "okay";
			};

			camera_sub@2d {
				compatible = "mediatek,camera_sub";
				phandle = <0x85>;
				reg = <0x2d>;
				status = "okay";
			};

			camera_sub_eeprom@52 {
				compatible = "mediatek,camera_sub_eeprom";
				phandle = <0x86>;
				reg = <0x52>;
				status = "okay";
			};

			ccu_sensor_i2c_4_hw@36 {
				compatible = "mediatek,ccu_sensor_i2c_4_hw";
				phandle = <0x8a>;
				reg = <0x36>;
				status = "okay";
			};
		};
	};

	fragment@43 {
		target = <0xffffffff>;

		__overlay__ {
			#address-cells = <0x01>;
			#size-cells = <0x00>;
			clock-frequency = <0x61a80>;
			mediatek,use-push-pull;

			subpmic@34 {
				compatible = "mediatek,subpmic";
				phandle = <0x8b>;
				reg = <0x34>;
				status = "okay";
			};

			subpmic_ldo@64 {
				compatible = "mediatek,subpmic_ldo";
				phandle = <0x8e>;
				reg = <0x64>;
				status = "okay";
			};

			subpmic_pmic@1a {
				compatible = "mediatek,subpmic_pmic";
				phandle = <0x8d>;
				reg = <0x1a>;
				status = "okay";
			};

			usb_type_c@4e {
				compatible = "mediatek,usb_type_c";
				phandle = <0x8c>;
				reg = <0x4e>;
				status = "okay";
			};
		};
	};

	fragment@44 {
		target = <0xffffffff>;

		__overlay__ {
			#address-cells = <0x01>;
			#size-cells = <0x00>;
			clock-frequency = <0x61a80>;
			mediatek,use-open-drain;

			speaker_amp@34 {
				compatible = "mediatek,speaker_amp";
				phandle = <0x8f>;
				reg = <0x34>;
				status = "okay";
			};
		};
	};

	fragment@45 {
		target = <0xffffffff>;

		__overlay__ {
			#address-cells = <0x01>;
			#size-cells = <0x00>;
			clock-frequency = <0x61a80>;
			mediatek,use-open-drain;

			ccu_sensor_i2c_7_hw@43 {
				compatible = "mediatek,ccu_sensor_i2c_7_hw";
				phandle = <0x90>;
				reg = <0x43>;
				status = "okay";
			};
		};
	};

	fragment@46 {
		target = <0xffffffff>;

		__overlay__ {
			#address-cells = <0x01>;
			#size-cells = <0x00>;
			clock-frequency = <0x61a80>;
			mediatek,use-open-drain;
		};
	};

	fragment@47 {
		target = <0xffffffff>;

		__overlay__ {
			#address-cells = <0x01>;
			#size-cells = <0x00>;
			clock-frequency = <0x33e140>;
			mediatek,use-open-drain;

			vproc_buck@6b {
				compatible = "mediatek,vproc_buck";
				phandle = <0x91>;
				reg = <0x6b>;
				status = "okay";
			};
		};
	};

	fragment@48 {
		target = <0xffffffff>;

		__overlay__ {
			GPIO_FDD_BAND_SUPPORT_DETECT_1ST_PIN = <0xffffffff 0x57 0x00>;
			GPIO_FDD_BAND_SUPPORT_DETECT_2ND_PIN = <0xffffffff 0x58 0x00>;
			GPIO_FDD_BAND_SUPPORT_DETECT_3RD_PIN = <0xffffffff 0x4a 0x00>;
			GPIO_FDD_BAND_SUPPORT_DETECT_4TH_PIN = <0xffffffff 0x49 0x00>;
			GPIO_SIM1_HOT_PLUG = <0xffffffff 0x8c 0x00>;
			GPIO_SIM1_SCLK = <0xffffffff 0x82 0x00>;
			GPIO_SIM1_SIO = <0xffffffff 0x80 0x00>;
			GPIO_SIM1_SRST = <0xffffffff 0x81 0x00>;
			GPIO_SIM2_HOT_PLUG = <0xffffffff 0x8d 0x00>;
			GPIO_SIM2_SCLK = <0xffffffff 0x83 0x00>;
			GPIO_SIM2_SIO = <0xffffffff 0x85 0x00>;
			GPIO_SIM2_SRST = <0xffffffff 0x84 0x00>;
		};
	};

	fragment@49 {
		target = <0xffffffff>;

		__overlay__ {
			gpio_init_default = <0x00 0x00 0x00 0x00 0x01 0x01 0x01 0x01 0x00 0x00 0x00 0x01 0x01 0x01 0x02 0x00 0x01 0x00 0x00 0x00 0x01 0x03 0x07 0x00 0x00 0x01 0x00 0x01 0x04 0x00 0x00 0x00 0x01 0x00 0x01 0x05 0x00 0x00 0x00 0x00 0x00 0x01 0x06 0x00 0x01 0x00 0x00 0x00 0x01 0x07 0x00 0x00 0x00 0x01 0x01 0x01 0x08 0x00 0x00 0x00 0x01 0x01 0x01 0x09 0x00 0x00 0x00 0x00 0x00 0x01 0x0a 0x00 0x00 0x00 0x01 0x01 0x01 0x0b 0x00 0x00 0x00 0x01 0x01 0x01 0x0c 0x00 0x00 0x00 0x01 0x01 0x00 0x0d 0x00 0x01 0x00 0x00 0x00 0x00 0x0e 0x00 0x01 0x00 0x00 0x00 0x00 0x0f 0x00 0x00 0x00 0x00 0x00 0x00 0x10 0x00 0x00 0x00 0x01 0x01 0x01 0x11 0x01 0x00 0x00 0x00 0x00 0x00 0x12 0x01 0x01 0x00 0x00 0x00 0x00 0x13 0x01 0x01 0x00 0x00 0x00 0x00 0x14 0x01 0x01 0x00 0x00 0x00 0x00 0x15 0x00 0x00 0x00 0x01 0x01 0x00 0x16 0x00 0x01 0x01 0x00 0x00 0x00 0x17 0x00 0x01 0x00 0x00 0x00 0x00 0x18 0x00 0x01 0x00 0x00 0x00 0x00 0x19 0x01 0x00 0x00 0x01 0x00 0x00 0x1a 0x00 0x01 0x00 0x00 0x00 0x00 0x1c 0x01 0x00 0x00 0x01 0x01 0x01 0x1d 0x01 0x00 0x00 0x01 0x01 0x01 0x1e 0x00 0x01 0x00 0x00 0x00 0x00 0x1f 0x00 0x00 0x00 0x01 0x01 0x00 0x20 0x00 0x00 0x00 0x01 0x01 0x00 0x21 0x00 0x00 0x00 0x01 0x00 0x00 0x22 0x00 0x01 0x00 0x00 0x00 0x00 0x23 0x06 0x00 0x00 0x01 0x00 0x00 0x24 0x06 0x00 0x00 0x00 0x00 0x00 0x25 0x06 0x00 0x00 0x01 0x00 0x00 0x26 0x06 0x01 0x00 0x00 0x00 0x00 0x27 0x06 0x00 0x00 0x01 0x00 0x00 0x28 0x06 0x00 0x00 0x01 0x00 0x00 0x29 0x06 0x00 0x00 0x01 0x00 0x00 0x2a 0x01 0x01 0x00 0x00 0x00 0x00 0x2b 0x01 0x00 0x00 0x01 0x00 0x00 0x2c 0x00 0x01 0x00 0x00 0x00 0x00 0x2d 0x01 0x00 0x00 0x01 0x01 0x01 0x2e 0x01 0x00 0x00 0x01 0x01 0x01 0x2f 0x01 0x00 0x00 0x01 0x00 0x00 0x30 0x01 0x01 0x00 0x00 0x00 0x00 0x31 0x01 0x01 0x00 0x00 0x00 0x00 0x32 0x01 0x01 0x00 0x00 0x00 0x00 0x33 0x01 0x00 0x00 0x01 0x01 0x01 0x34 0x01 0x00 0x00 0x01 0x01 0x01 0x35 0x01 0x00 0x00 0x01 0x01 0x00 0x36 0x01 0x01 0x01 0x00 0x00 0x00 0x37 0x01 0x00 0x00 0x01 0x01 0x01 0x38 0x01 0x00 0x00 0x01 0x01 0x01 0x39 0x00 0x00 0x00 0x01 0x00 0x00 0x3a 0x00 0x00 0x00 0x00 0x00 0x00 0x3b 0x01 0x00 0x00 0x01 0x01 0x00 0x3c 0x01 0x00 0x00 0x01 0x01 0x00 0x3d 0x02 0x00 0x00 0x01 0x01 0x01 0x3e 0x02 0x00 0x00 0x01 0x01 0x01 0x3f 0x02 0x00 0x00 0x01 0x00 0x00 0x40 0x02 0x01 0x00 0x00 0x00 0x00 0x41 0x02 0x01 0x00 0x00 0x00 0x00 0x42 0x02 0x01 0x00 0x00 0x00 0x00 0x43 0x00 0x00 0x00 0x00 0x00 0x01 0x44 0x00 0x00 0x00 0x00 0x00 0x01 0x45 0x00 0x00 0x00 0x01 0x01 0x01 0x46 0x00 0x00 0x00 0x00 0x00 0x00 0x47 0x00 0x00 0x00 0x00 0x00 0x01 0x48 0x00 0x01 0x00 0x00 0x00 0x00 0x49 0x00 0x00 0x00 0x00 0x00 0x00 0x4a 0x00 0x00 0x00 0x00 0x00 0x00 0x4b 0x00 0x00 0x00 0x01 0x00 0x00 0x4c 0x01 0x00 0x00 0x01 0x00 0x00 0x4d 0x01 0x00 0x00 0x01 0x00 0x00 0x4e 0x01 0x00 0x00 0x01 0x00 0x00 0x4f 0x01 0x00 0x00 0x01 0x00 0x00 0x50 0x01 0x00 0x00 0x01 0x00 0x00 0x51 0x01 0x00 0x00 0x01 0x00 0x00 0x52 0x01 0x00 0x00 0x01 0x00 0x00 0x53 0x01 0x00 0x00 0x01 0x00 0x00 0x54 0x01 0x00 0x00 0x01 0x00 0x00 0x55 0x01 0x00 0x00 0x01 0x00 0x00 0x56 0x01 0x00 0x00 0x01 0x00 0x00 0x57 0x00 0x00 0x00 0x00 0x00 0x00 0x58 0x00 0x00 0x00 0x00 0x00 0x00 0x59 0x01 0x00 0x00 0x01 0x00 0x00 0x5a 0x01 0x00 0x00 0x01 0x00 0x00 0x5b 0x01 0x00 0x00 0x01 0x00 0x00 0x5c 0x01 0x00 0x00 0x01 0x00 0x00 0x5d 0x01 0x00 0x00 0x01 0x00 0x00 0x5e 0x01 0x00 0x00 0x01 0x00 0x00 0x5f 0x01 0x00 0x00 0x01 0x00 0x00 0x60 0x01 0x00 0x00 0x01 0x00 0x00 0x61 0x01 0x00 0x00 0x01 0x00 0x00 0x62 0x01 0x00 0x00 0x01 0x00 0x00 0x63 0x01 0x00 0x00 0x01 0x00 0x00 0x64 0x01 0x00 0x00 0x01 0x00 0x00 0x65 0x01 0x00 0x00 0x01 0x00 0x00 0x66 0x01 0x00 0x00 0x01 0x00 0x00 0x67 0x01 0x00 0x00 0x01 0x00 0x00 0x68 0x01 0x00 0x00 0x01 0x00 0x00 0x69 0x01 0x00 0x00 0x01 0x00 0x00 0x6a 0x01 0x00 0x00 0x01 0x00 0x00 0x6b 0x01 0x00 0x00 0x01 0x00 0x00 0x6c 0x01 0x00 0x00 0x01 0x00 0x00 0x6d 0x00 0x00 0x00 0x00 0x00 0x00 0x6e 0x01 0x00 0x00 0x01 0x01 0x01 0x6f 0x01 0x00 0x00 0x01 0x01 0x01 0x70 0x01 0x00 0x00 0x01 0x01 0x01 0x71 0x01 0x00 0x00 0x01 0x01 0x01 0x72 0x00 0x01 0x00 0x00 0x00 0x00 0x73 0x00 0x01 0x00 0x00 0x00 0x00 0x74 0x01 0x01 0x00 0x00 0x00 0x00 0x75 0x01 0x01 0x00 0x00 0x00 0x00 0x76 0x00 0x01 0x00 0x00 0x00 0x00 0x77 0x00 0x01 0x00 0x00 0x00 0x00 0x78 0x01 0x01 0x00 0x00 0x00 0x00 0x79 0x01 0x01 0x00 0x00 0x00 0x00 0x7a 0x00 0x01 0x00 0x00 0x00 0x00 0x7b 0x00 0x01 0x00 0x00 0x00 0x00 0x7c 0x00 0x01 0x00 0x00 0x00 0x00 0x7d 0x00 0x01 0x00 0x00 0x00 0x00 0x7e 0x00 0x01 0x00 0x00 0x00 0x00 0x7f 0x00 0x01 0x00 0x00 0x00 0x00 0x80 0x01 0x00 0x00 0x01 0x01 0x01 0x81 0x01 0x01 0x00 0x00 0x00 0x01 0x82 0x01 0x01 0x00 0x00 0x00 0x01 0x83 0x01 0x01 0x00 0x00 0x00 0x01 0x84 0x01 0x01 0x00 0x00 0x00 0x01 0x85 0x01 0x00 0x00 0x01 0x01 0x01 0x86 0x01 0x01 0x00 0x00 0x00 0x01 0x87 0x01 0x00 0x00 0x01 0x01 0x01 0x88 0x01 0x00 0x00 0x01 0x01 0x01 0x89 0x01 0x00 0x00 0x01 0x01 0x01 0x8a 0x01 0x00 0x00 0x01 0x01 0x01 0x8b 0x01 0x00 0x00 0x01 0x01 0x01 0x8c 0x01 0x00 0x00 0x01 0x01 0x01 0x8d 0x01 0x00 0x00 0x01 0x01 0x01 0x8e 0x01 0x01 0x00 0x00 0x00 0x00 0x8f 0x01 0x01 0x00 0x00 0x00 0x01 0x90 0x01 0x01 0x00 0x00 0x00 0x01 0x91 0x01 0x01 0x00 0x00 0x00 0x01 0x92 0x01 0x00 0x00 0x01 0x00 0x01 0x93 0x00 0x00 0x00 0x01 0x00 0x00 0x94 0x00 0x00 0x00 0x01 0x00 0x00 0x95 0x00 0x00 0x00 0x01 0x00 0x00 0x96 0x01 0x01 0x00 0x00 0x00 0x00 0x97 0x01 0x00 0x00 0x01 0x01 0x01 0x98 0x01 0x00 0x00 0x01 0x01 0x01 0x99 0x01 0x01 0x00 0x01 0x01 0x00 0x9a 0x00 0x00 0x00 0x01 0x00 0x00 0x9b 0x00 0x01 0x00 0x00 0x00 0x00 0x9c 0x00 0x01 0x00 0x00 0x00 0x00 0x9d 0x00 0x01 0x00 0x00 0x00 0x00 0x9e 0x00 0x01 0x00 0x00 0x00 0x00 0x9f 0x00 0x01 0x00 0x00 0x00 0x00 0xa0 0x00 0x01 0x00 0x00 0x00 0x00 0xa1 0x00 0x01 0x00 0x00 0x00 0x00 0xa2 0x00 0x01 0x00 0x00 0x00 0x00 0xa3 0x00 0x01 0x00 0x00 0x00 0x00 0xa4 0x00 0x01 0x00 0x00 0x00 0x00 0xa5 0x01 0x01 0x00 0x01 0x01 0x00 0xa6 0x01 0x00 0x00 0x01 0x01 0x00 0xa8 0x00 0x00 0x00 0x01 0x01 0x01 0xb3 0x01 0x00 0x00 0x01 0x00 0x00 0xb4 0x01 0x00 0x00 0x01 0x00 0x00 0xb5 0x01 0x01 0x00 0x00 0x00 0x00 0xb6 0x01 0x01 0x00 0x00 0x00 0x00 0xb7 0x01 0x01 0x00 0x00 0x00 0x00 0xb8 0x01 0x00 0x00 0x01 0x00 0x00 0xb9 0x01 0x01 0x00 0x00 0x00 0x00 0xba 0x01 0x00 0x00 0x01 0x00 0x00 0xbb 0x01 0x01 0x00 0x00 0x00 0x00 0xbc 0x01 0x00 0x00 0x01 0x00 0x01 0xbd 0x01 0x01 0x00 0x00 0x00 0x01 0xbe 0x01 0x01 0x00 0x00 0x00 0x01 0xbf 0x01 0x01 0x00 0x00 0x00 0x01 0xc0 0x01 0x01 0x00 0x00 0x00 0x01 0xc1 0x01 0x00 0x00 0x01 0x00 0x01 0xc2 0x01 0x00 0x00 0x01 0x00 0x01 0xc3 0x00 0x01 0x00 0x00 0x00 0x00 0xc4 0x01 0x01 0x00 0x00 0x00 0x00 0xc5 0x00 0x01 0x00 0x00 0x00 0x00 0xc6 0x01 0x00 0x00 0x01 0x01 0x01 0xc7 0x01 0x00 0x00 0x01 0x01 0x01 0xc8 0x01 0x00 0x00 0x01 0x01 0x00 0xc9 0x01 0x01 0x00 0x00 0x00 0x00 0xca 0x00 0x01 0x00 0x00 0x00 0x00 0xcb 0x00 0x00 0x00 0x01 0x00 0x00 0xcc 0x00 0x00 0x00 0x01 0x00 0x00 0xcd 0x00 0x00 0x00 0x01 0x00 0x00 0xce 0x00 0x00 0x00 0x01 0x00 0x00 0xcf 0x00 0x00 0x00 0x01 0x00 0x00 0xd0 0x00 0x00 0x00 0x01 0x00 0x00 0xd1 0x00 0x00 0x00 0x01 0x00 0x00 0xd2 0x00 0x00 0x00 0x01 0x00 0x00>;
		};
	};

	fragment@5 {
		target = <0xffffffff>;

		__overlay__ {
			clock-frequency = <0x61a80>;

			mtk-usb@60 {
				compatible = "mediatek,mtk-usb";
				reg = <0x60>;
				status = "okay";
			};
		};
	};

	fragment@50 {
		target = <0xffffffff>;

		__overlay__ {
			deb-gpios = <0xffffffff 0x00 0x00>;
			debounce = <0x7d000>;
			interrupt-parent = <0xffffffff>;
			interrupts = <0x00 0x08 0x00 0x00>;
			status = "okay";
		};
	};

	fragment@51 {
		target = <0xffffffff>;

		__overlay__ {
			interrupt-parent = <0xffffffff>;
			interrupts = <0x01 0x02 0x01 0x00>;
			status = "okay";
		};
	};

	fragment@52 {
		target = <0xffffffff>;

		__overlay__ {
			interrupt-parent = <0xffffffff>;
			interrupts = <0x05 0x04 0x05 0x00>;
			status = "okay";
		};
	};

	fragment@53 {
		target = <0xffffffff>;

		__overlay__ {
			interrupt-parent = <0xffffffff>;
			interrupts = <0x07 0x02 0x07 0x00>;
			status = "okay";
		};
	};

	fragment@54 {
		target = <0xffffffff>;

		__overlay__ {
			interrupt-parent = <0xffffffff>;
			interrupts = <0x08 0x08 0x08 0x00>;
			status = "okay";
		};
	};

	fragment@55 {
		target = <0xffffffff>;

		__overlay__ {
			interrupt-parent = <0xffffffff>;
			interrupts = <0x10 0x02 0x10 0x00>;
			status = "okay";
		};
	};

	fragment@56 {
		target = <0xffffffff>;

		__overlay__ {
			interrupt-parent = <0xffffffff>;
			interrupts = <0x2b 0x01 0x2b 0x01>;
			status = "okay";
		};
	};

	fragment@57 {
		target = <0xffffffff>;

		__overlay__ {
			interrupt-parent = <0xffffffff>;
			interrupts = <0x45 0x08 0x45 0x00>;
			status = "okay";
		};
	};

	fragment@58 {
		target = <0xffffffff>;

		__overlay__ {
			interrupt-parent = <0xffffffff>;
			interrupts = <0x4b 0x02 0x4b 0x00>;
			status = "okay";
		};
	};

	fragment@59 {
		target = <0xffffffff>;

		__overlay__ {
			deb-gpios = <0xffffffff 0x6d 0x00>;
			debounce = <0x7d000>;
			interrupt-parent = <0xffffffff>;
			interrupts = <0x6d 0x04 0x6d 0x00>;
			status = "okay";
		};
	};

	fragment@6 {
		target = <0xffffffff>;

		__overlay__ {
			accdet-mic-mode = <0x02>;
			accdet-mic-vol = <0x08>;
			accdet-plugout-debounce = <0x01>;
			eint_detect_mode = <0x05>;
			eint_use_ext_res = <0x00>;
			headset-four-key-threshold = <0x00 0x3a 0x79 0xc0 0x190>;
			headset-mode-setting = <0x500 0x500 0x01 0x1f0 0x2000 0x800 0x2000 0x44 0x00 0x07 0x05 0x09 0x09 0x0d 0x0e>;
			headset-three-key-threshold = <0x00 0x50 0xbe 0x190>;
			headset-three-key-threshold-CDD = <0x00 0x79 0xc0 0x258>;
			moisture-external-r = <0x1e8480>;
			moisture-internal-r = <0xb798>;
			moisture-water-r = <0x2710>;
			moisture_comp_vref2 = <0x00>;
			moisture_comp_vth = <0x02>;
			moisture_detect_enable = <0x01>;
			moisture_detect_mode = <0x05>;
			moisture_use_ext_res = <0x00>;
			status = "okay";
		};
	};

	fragment@60 {
		target = <0xffffffff>;

		__overlay__ {
			interrupt-parent = <0xffffffff>;
			interrupts = <0xc1 0x04 0xd1 0x00>;
			status = "okay";
		};
	};

	fragment@61 {
		target = <0xffffffff>;

		__overlay__ {
			compatible = "mediatek,md1_sim1_hot_plug_eint-eint";
			debounce = <0x00 0xc350>;
			dedicated = <0x00 0x00>;
			interrupts = <0x00 0x08>;
			sockettype = <0x00 0x00>;
			src_pin = <0x00 0x01>;
			status = "okay";
		};
	};

	fragment@62 {
		target = <0xffffffff>;

		__overlay__ {
			compatible = "mediatek,md1_sim2_hot_plug_eint-eint";
			debounce = <0x01 0xc350>;
			dedicated = <0x01 0x00>;
			interrupts = <0x01 0x08>;
			sockettype = <0x01 0x00>;
			src_pin = <0x01 0x02>;
			status = "okay";
		};
	};

	fragment@63 {
		target = <0xffffffff>;

		__overlay__ {
			regulator-default-on = <0x01>;
			regulator-name = "vcamio";
			status = "okay";
		};
	};

	fragment@64 {
		target = <0xffffffff>;

		__overlay__ {
			regulator-default-on = <0x02>;
			regulator-name = "vtp";
			status = "okay";
		};
	};

	fragment@65 {
		target = <0xffffffff>;

		__overlay__ {
			status = "okay";
			vcamio-supply = <0xffffffff>;
			vcamio_main2-supply = <0xffffffff>;
			vcamio_main3-supply = <0xffffffff>;
			vcamio_sub-supply = <0xffffffff>;
			vcamio_sub2-supply = <0xffffffff>;
		};
	};

	fragment@66 {
		target = <0xffffffff>;

		__overlay__ {
			status = "okay";
			vtouch-supply = <0xffffffff>;
		};
	};

	fragment@67 {
		target = <0xffffffff>;

		__overlay__ {
			mediatek,kpd-hw-dl-key0 = <0x11>;
			mediatek,kpd-hw-dl-key1 = <0x01>;
			mediatek,kpd-hw-dl-key2 = <0x08>;
			mediatek,kpd-hw-init-map = <0x00 0x72 0x00 0x00 0x00 0x00 0x00 0x00 0x00 0x00 0x00 0x00 0x00 0x00 0x00 0x00 0x00 0x00 0x00 0x00 0x00 0x00 0x00 0x00 0x00 0x00 0x00 0x00 0x00 0x00 0x00 0x00 0x00 0x00 0x00 0x00 0x00 0x00 0x00 0x00 0x00 0x00 0x00 0x00 0x00 0x00 0x00 0x00 0x00 0x00 0x00 0x00 0x00 0x00 0x00 0x00 0x00 0x00 0x00 0x00 0x00 0x00 0x00 0x00 0x00 0x00 0x00 0x00 0x00 0x00 0x00 0x00>;
			mediatek,kpd-hw-map-num = <0x48>;
			mediatek,kpd-hw-pwrkey = <0x08>;
			mediatek,kpd-hw-recovery-key = <0x01>;
			mediatek,kpd-hw-rstkey = <0x11>;
			mediatek,kpd-key-debounce = <0x400>;
			mediatek,kpd-pwkey-gpio-din = <0x00>;
			mediatek,kpd-pwrkey-eint-gpio = <0x00>;
			mediatek,kpd-sw-pwrkey = <0x74>;
			mediatek,kpd-sw-rstkey = <0x73>;
			mediatek,kpd-use-extend-type = <0x00>;
			status = "okay";
		};
	};

	fragment@7 {
		target = <0xffffffff>;

		__overlay__ {

			kpd_volume_down {
				compatible = "mediatek, VOLUME_DOWN-eint";
				debounce = <0x7d00>;
				interrupt-parent = <0xffffffff>;
				interrupts = <0x3c 0x02 0x3c 0x00>;
				phandle = <0x79>;
				status = "okay";
			};

			kpd_volume_up {
				compatible = "mediatek, VOLUME_UP-eint";
				debounce = <0x7d00>;
				interrupt-parent = <0xffffffff>;
				interrupts = <0x3b 0x02 0x3b 0x00>;
				phandle = <0x78>;
				status = "okay";
			};

			led@0 {
				compatible = "mediatek,red";
				data = <0x01>;
				led_mode = <0x00>;
				phandle = <0x6d>;
				pwm_config = <0x00 0x00 0x00 0x00 0x00>;
			};

			led@1 {
				compatible = "mediatek,green";
				data = <0x01>;
				led_mode = <0x00>;
				phandle = <0x6e>;
				pwm_config = <0x00 0x00 0x00 0x00 0x00>;
			};

			led@2 {
				compatible = "mediatek,blue";
				data = <0x01>;
				led_mode = <0x00>;
				phandle = <0x6f>;
				pwm_config = <0x00 0x00 0x00 0x00 0x00>;
			};

			led@3 {
				compatible = "mediatek,jogball-backlight";
				data = <0x01>;
				led_mode = <0x00>;
				phandle = <0x70>;
				pwm_config = <0x00 0x00 0x00 0x00 0x00>;
			};

			led@4 {
				compatible = "mediatek,keyboard-backlight";
				data = <0x01>;
				led_mode = <0x00>;
				phandle = <0x71>;
				pwm_config = <0x00 0x00 0x00 0x00 0x00>;
			};

			led@5 {
				compatible = "mediatek,button-backlight";
				data = <0x01>;
				led_mode = <0x00>;
				phandle = <0x72>;
				pwm_config = <0x00 0x00 0x00 0x00 0x00>;
			};

			led@6 {
				compatible = "mediatek,lcd-backlight";
				data = <0x01>;
				led_mode = <0x04>;
				phandle = <0x73>;
				pwm_config = <0x00 0x01 0x00 0x00 0x00>;
			};

			memory-ssmr-features {
				2d_fr-size = <0x00 0x00>;
				compatible = "mediatek,memory-ssmr-features";
				iris-recognition-size = <0x00 0x00>;
				phandle = <0x75>;
				prot-sharedmem-size = <0x00 0x00>;
				svp-size = <0x00 0xc000000>;
				tui-size = <0x00 0x00>;
				wfd-size = <0x00 0x00>;
			};

			oppo_devinfo {
				compatible = "oppo, device_info";
				nfc_board-gpio0 = <0xffffffff 0x9a 0x00>;
				nfc_board-gpio1 = <0xffffffff 0x1e 0x00>;
				nfc_board-gpio2 = <0xffffffff 0x21 0x00>;
				phandle = <0x7b>;
				sdcard-gpio = <0xffffffff 0x08 0x00>;
				sub_board-gpio = <0xffffffff 0x09 0x00>;
			};

			oppo_project {
				compatible = "oppo,oppo_project";
				phandle = <0x7a>;
			};

			oppo_sensor {
				phandle = <0x77>;
			};

			usb_c_pinctrl {
				compatible = "mediatek,usb_c_pinctrl";
				phandle = <0x76>;
				pinctrl-0 = <0x0c>;
				pinctrl-1 = <0x0d>;
				pinctrl-10 = <0x16>;
				pinctrl-11 = <0x17>;
				pinctrl-12 = <0x18>;
				pinctrl-2 = <0x0e>;
				pinctrl-3 = <0x0f>;
				pinctrl-4 = <0x10>;
				pinctrl-5 = <0x11>;
				pinctrl-6 = <0x12>;
				pinctrl-7 = <0x13>;
				pinctrl-8 = <0x14>;
				pinctrl-9 = <0x15>;
				pinctrl-names = "usb_default\0redrv_c1_init\0redrv_c1_low\0redrv_c1_hiz\0redrv_c1_high\0redrv_c2_init\0redrv_c2_low\0redrv_c2_hiz\0redrv_c2_high\0switch_sel1\0switch_sel2\0switch_enable\0switch_disable";
				status = "okay";

				usb_switch-data {
					c1_pin_num = <0x1f>;
					c1_pin_val = <0x02>;
					c2_pin_num = <0x1e>;
					c2_pin_val = <0x01>;
					en_pin_num = <0x00>;
					en_pin_val = <0x00>;
					sel_pin_num = <0x20>;
					sel_pin_val = <0x01>;
				};
			};

			vibrator@0 {
				compatible = "mediatek,vibrator";
				phandle = <0x74>;
				vib_limit = <0x00>;
				vib_timer = <0x1e>;
				vib_vol = <0x0b>;
			};
		};
	};

	fragment@8 {
		target = <0xffffffff>;

		__overlay__ {

			lcd_bias_enn0_gpio {
				phandle = <0x1c>;

				pins_cmd_dat {
					output-low;
					pinmux = <0xca00>;
					slew-rate = <0x01>;
				};
			};

			lcd_bias_enn1_gpio {
				phandle = <0x1b>;

				pins_cmd_dat {
					output-high;
					pinmux = <0xca00>;
					slew-rate = <0x01>;
				};
			};

			lcd_bias_enp0_gpio {
				phandle = <0x1a>;

				pins_cmd_dat {
					output-low;
					pinmux = <0x1700>;
					slew-rate = <0x01>;
				};
			};

			lcd_bias_enp1_gpio {
				phandle = <0x19>;

				pins_cmd_dat {
					output-high;
					pinmux = <0x1700>;
					slew-rate = <0x01>;
				};
			};

			lcm_dsi_te {
				phandle = <0x1f>;

				pins_cmd_dat {
					pinmux = <0x2b01>;
				};
			};

			lcm_rst_out0_gpio {
				phandle = <0x1e>;

				pins_cmd_dat {
					output-low;
					pinmux = <0x2c00>;
					slew-rate = <0x01>;
				};
			};

			lcm_rst_out1_gpio {
				phandle = <0x1d>;

				pins_cmd_dat {
					output-high;
					pinmux = <0x2c00>;
					slew-rate = <0x01>;
				};
			};
		};
	};

	fragment@9 {
		target = <0xffffffff>;

		__overlay__ {
			pinctrl-0 = <0x19>;
			pinctrl-1 = <0x1a>;
			pinctrl-2 = <0x1b>;
			pinctrl-3 = <0x1c>;
			pinctrl-4 = <0x1d>;
			pinctrl-5 = <0x1e>;
			pinctrl-6 = <0x1f>;
			pinctrl-names = "lcd_bias_enp1_gpio\0lcd_bias_enp0_gpio\0lcd_bias_enn1_gpio\0lcd_bias_enn0_gpio\0lcm_rst_out1_gpio\0lcm_rst_out0_gpio\0mode_te_te";
			status = "okay";
		};
	};
};
